PROVIDE(Cd_FilePathPrefix = D_8008A854);
PROVIDE(Cd_FilePathSuffixArea = D_8008A858);
PROVIDE(Cd_ReadModeHeight = D_8008A8B4);
PROVIDE(Cd_ReadModeWidth = D_8008A8B0);
PROVIDE(CdActiveFilePtr = D_8008A874);
PROVIDE(CdDaCallbackActive = D_8008A89C);
PROVIDE(CdDaFileQueued = D_8008A850);
PROVIDE(CdDaUpdateLock = D_8008A88C);
PROVIDE(CdDaVsyncInstalled = D_8008A890);
PROVIDE(CdFileCount = D_8008A86C);
PROVIDE(CdFileIndex = D_8008A85C);
PROVIDE(CdFileListBase = D_8008A868);
PROVIDE(CdFileParam = D_8008A860);
PROVIDE(CdJobListHead = D_8008A894);
PROVIDE(CdModeSelector = D_8008A84C);
PROVIDE(CdNextBufferAddr = D_8008A888);
PROVIDE(CdOperationBusy = D_8008A864);
PROVIDE(CdOperationPending = D_8008A898);
PROVIDE(CdReadBufferPtr = D_8008A884);
PROVIDE(CdReadDone = D_8008A870);
PROVIDE(CdReadSectorCount = D_8008A880);
PROVIDE(CdSeekSectorAddr = D_8008A87C);
PROVIDE(CdStateMachine = D_8008A878);
PROVIDE(CdTimeoutCounter = D_8008A8A0);
PROVIDE(CdVsyncMode = D_8008A8A4);
PROVIDE(DreamAngleDataTable = D_8008875C);
PROVIDE(DreamCamMotionAmp = D_80087E20);
PROVIDE(DreamCamMotionClamp = D_80087E74);
PROVIDE(DreamCamMotionStep = D_80087E68);
PROVIDE(DreamCamMotionStepVal = D_80087E84);
PROVIDE(DreamCamSwayAccel = D_80087E50);
PROVIDE(DreamCamSwayLimit = D_80087E5C);
PROVIDE(DreamColourEffectData = D_80087E80);
PROVIDE(DreamDefaultVisual = D_80087E08);
PROVIDE(DreamFlashbackReverb = D_80087EA4);
PROVIDE(DreamInstantTeleportFlag = D_8008ABE4);
PROVIDE(DreamInterpParamStore = D_80087EE8);
PROVIDE(DreamLinkActionFuncs = D_80087E3C);
PROVIDE(DreamLinkActionScale = D_80087E34);
PROVIDE(DreamLinkSoundBank = D_80087EB0);
PROVIDE(DreamLinkSoundOffset = D_80087EC8);
PROVIDE(DreamStaircaseColourAC = D_80087EFC);
PROVIDE(DreamStaircaseColourBD = D_80087F08);
PROVIDE(DreamStaircaseDefaultData = D_8008ABF0);
PROVIDE(DreamStaircaseSpawnCount = D_80088CBC);
PROVIDE(DreamStaircaseTargetA = D_8008ABC0);
PROVIDE(DreamStaircaseTargetB = D_8008ABC8);
PROVIDE(DreamStaircaseTargetC = D_8008ABD0);
PROVIDE(DreamStaircaseTargetD = D_8008ABD8);
PROVIDE(DreamSymbolSequence = D_80087BD4);
PROVIDE(ENTITY_Construct = func_80044a0c);
PROVIDE(EntityFieldSetupData = D_8008AB10);
PROVIDE(EntityLayerRegisterFuncTable = D_800874B0);
PROVIDE(EntityVisualColourSet = D_8008ABA4);
PROVIDE(ExecSoundAction = func_8005cab4);
PROVIDE(FrameRatePalFlag = D_8006DCA8);
PROVIDE(FrameRateSetting = D_8006DCA4);
PROVIDE(DreamColorMapTable = D_80087E14);
PROVIDE(EntityEffectDataTable = D_80089EA4);
PROVIDE(EntityMoodEffectWeight = D_80089EA6);
PROVIDE(EntityLinkStage = D_80089EAB);
PROVIDE(EntityEventVideo = D_80089EAC);
PROVIDE(EntityMoveScaleFactor = D_80089EAE);
PROVIDE(EntityActiveFlag = D_80089EAF);
PROVIDE(System_HeapBase = D_8008A808);
PROVIDE(DreamNullMoodPoint = D_8008ABF4);
PROVIDE(DefaultAttachmentParam_A = D_8008AC0C);
PROVIDE(DefaultAttachmentParam_B = D_8008AC14);
PROVIDE(GameStatePtr = D_8008AC20);
PROVIDE(Spawn_VisitFlagArray = D_8008ACB4);
PROVIDE(Spawn_CurrentChunkIdx = D_8008ACBC);
PROVIDE(Spawn_CurrentEntryIdx = D_8008ACC0);
PROVIDE(Spawn_CurrentType = D_8008ACC4);
PROVIDE(Spawn_CurrentSubType = D_8008ACC8);
PROVIDE(GpuGlobalBboxBuffer = D_8008B21C);
PROVIDE(Pad_InitState = D_8008B3C8);
PROVIDE(Pad_Mode = D_8008E984);


PROVIDE(func_80028b78 = strcpy);
PROVIDE(func_80028B78 = strcpy);
PROVIDE(func_80028c54 = CdReset);
PROVIDE(func_80028C54 = CdReset);
PROVIDE(func_80028d68 = CdSync);
PROVIDE(func_80028D68 = CdSync);
PROVIDE(func_80028d88 = CdReady);
PROVIDE(func_80028D88 = CdReady);
PROVIDE(func_80028da8 = CdSyncCallback);
PROVIDE(func_80028DA8 = CdSyncCallback);
PROVIDE(func_80028dc0 = CdReadyCallback);
PROVIDE(func_80028DC0 = CdReadyCallback);
PROVIDE(func_80028dd8 = CdReadCallback);
PROVIDE(func_80028DD8 = CdReadCallback);
PROVIDE(func_80028df0 = CdControl);
PROVIDE(func_80028DF0 = CdControl);
PROVIDE(func_80028f38 = CdControlF);
PROVIDE(func_80028F38 = CdControlF);
PROVIDE(func_80029210 = CdDataCallback);
PROVIDE(func_8002b640 = CdSearchFile);
PROVIDE(func_8002B640 = CdSearchFile);
PROVIDE(GameManagerPtr = D_800878D4);
PROVIDE(GameManagerPtr2 = D_800879C4);
PROVIDE(Get_vtable_EntitySub = func_80066818);
PROVIDE(GetBasicVtab = func_80018390);
PROVIDE(Gpu_CurPrimPtr = D_8008E794);
PROVIDE(Gpu_DitherMode = D_8008E248);
PROVIDE(Gpu_PageMode = D_80090C18);
PROVIDE(Gpu_SemiTrans = D_8008E24C);
PROVIDE(Gpu_TexDisableFlag = D_800902E0);
PROVIDE(Gpu_TexMapFlag = D_8008E250);
PROVIDE(GpuCurrentDisplayList = D_8008A83C);
PROVIDE(GpuReady = D_8008AC4C);
PROVIDE(GsGpuDisplayListVtable = D_8006C070);
PROVIDE(GsGpuVtable = D_8006BEA0);
PROVIDE(Memory_AudioTypeVtable = D_800817E0);
PROVIDE(Memory_ObjType10Vtable = D_8006F06C);
PROVIDE(Memory_ObjType11Vtable = D_8006F0B8);
PROVIDE(Memory_ObjType12Vtable = D_8006F13C);
PROVIDE(Memory_ObjType13Vtable = D_8006F1C4);
PROVIDE(Memory_ObjType14Vtable = D_8006F240);
PROVIDE(Memory_ObjType15Vtable = D_8006F2C4);
PROVIDE(Memory_ObjType16Vtable = D_8006F384);
PROVIDE(Memory_ObjType17Vtable = D_8006F40C);
PROVIDE(Memory_ObjType18Vtable = D_8006F498);
PROVIDE(Memory_ObjType19Vtable = D_8006F514);
PROVIDE(Memory_ObjType1Vtable = D_8006E99C);
PROVIDE(Memory_ObjType20Vtable = D_8006F590);
PROVIDE(Memory_ObjType22Vtable = D_8006F614);
PROVIDE(Memory_ObjType24Vtable = D_80081940);
PROVIDE(Memory_ObjType2Vtable = D_8006EAC0);
PROVIDE(Memory_ObjType3Vtable = D_8006EB90);
PROVIDE(Memory_ObjType4Vtable = D_8006EC74);
PROVIDE(Memory_ObjType5Vtable = D_8006ED4C);
PROVIDE(Memory_ObjType6Vtable = D_8006EE1C);
PROVIDE(Memory_ObjType7Vtable = D_8006EED8);
PROVIDE(Memory_ObjType8Vtable = D_8006EF50);
PROVIDE(Memory_ObjType9Vtable = D_8006EFAC);
PROVIDE(Memory_SoundEffectIndex = D_8008A968);
PROVIDE(Memory_SoundEffectOffsetTbl = D_800819E8);
PROVIDE(Memory_SoundPathCdi = D_8008A958);
PROVIDE(MusicVolLineDataStage2 = D_80087444);
PROVIDE(MusicVolLineDataStage3 = D_8008745C);
PROVIDE(MusicVolLineTargetStage2 = D_80087450);
PROVIDE(MusicVolLineTargetStage3 = D_80087468);
PROVIDE(New_EntityAttachment = EntityAllocLarge);
PROVIDE(Other_AmbientEventData = D_80088D28);
PROVIDE(Other_CoordSysVtable = D_8006B58C);
PROVIDE(Other_CurrentEntityPtr = D_8008ABFC);
PROVIDE(Other_DebugInputVtable = D_8008A6C4);
PROVIDE(Other_DreamStateNum = D_8008ABF8);
PROVIDE(Other_DreamSysStatePtr = D_8008AC00);
PROVIDE(Other_EntityListIter = D_80088D2C);
PROVIDE(Other_GlobalPtr = D_8008A838);
PROVIDE(Other_MemHeapPtr = D_8008A818);
PROVIDE(Other_MemLockValue = D_8008A820);
PROVIDE(Other_OTEntryQuadBuf = D_8008AEE8);
PROVIDE(Other_OTEntryTriBuf = D_8008ACD0);
PROVIDE(Other_RotationData = D_80088D40);
PROVIDE(Other_SoundDirTable = D_80088F48);
PROVIDE(Other_SoundEffectVtableAlt = D_8006B5CC);
PROVIDE(Other_SoundEntityParam = D_8008AC04);
PROVIDE(Other_SoundEntityParam2 = D_8008AC08);
PROVIDE(Other_SoundTypeDataTbl = D_80089A44);
PROVIDE(Other_SoundTypeLookupTbl = D_80089A8C);
PROVIDE(ParticleChunkPalette = D_8008AC8C);
PROVIDE(ParticleColourTable = D_80087174);
PROVIDE(ParticleConfigParam = D_8008AC78);
PROVIDE(ParticleDefVtableArray = D_8008730C);
PROVIDE(ParticleEffectObject = D_8008AC94);
PROVIDE(ParticleEffectObjectType = D_8008AB60);
PROVIDE(ParticleEffectParam2 = D_8008AB58);
PROVIDE(ParticleEffectSelector = D_8008AC74);
PROVIDE(ParticleEffectVtable = D_8008AB54);
PROVIDE(ParticleEntityScanIndex = D_8008AC98);
PROVIDE(ParticleExtraChunkPtr = D_8008AC90);
PROVIDE(ParticleFixedVelocity = D_80087204);
PROVIDE(ParticleFrameCounter = D_8008AC70);
PROVIDE(ParticleGridTier = D_8008AB50);
PROVIDE(ParticleInitScratch = D_8008ACA0);
PROVIDE(ParticleMode = D_8008AC80);
PROVIDE(ParticleModeDenomTable = D_800873D8);
PROVIDE(ParticleModeIndexTable = D_800873DC);
PROVIDE(ParticleModeSubIndex = D_8008AC84);
PROVIDE(ParticlePaletteAlt = D_80087234);
PROVIDE(ParticlePaletteDefault = D_8008726C);
PROVIDE(ParticleRandomColourArray = D_80087328);
PROVIDE(ParticleSecondarySlots = D_8008AC9C);
PROVIDE(ParticleSpawnAllocator = D_8008ACA8);
PROVIDE(ParticleStageDefTable = D_800873EC);
PROVIDE(ParticleStageIndex = D_8008AC6C);
PROVIDE(ParticleStageObject = D_8008ACA4);
PROVIDE(ParticleSysEntityPtr = D_8008AB4C);
PROVIDE(ParticleTickTimer = D_8008ACAC);
PROVIDE(ParticleTickTimerValue = D_8008ACB0);
PROVIDE(ParticleWorldPtr = D_8008AC7C);
PROVIDE(Pad_Manager = D_8006D370);
PROVIDE(Pad_RefCount = D_8008A848);
PROVIDE(Pad_InputMaskTable = D_8008B388);
PROVIDE(DreamSys_CinemaState = D_8008AC00);
PROVIDE(DreamSys_CinemaState_04 = D_8008ABFC);
PROVIDE(DreamSys_CinemaState_08 = D_8008AC08);
PROVIDE(PrimCdDaVtable = D_8006D4E8);
PROVIDE(PrimCdVtable = D_8006D430);
PROVIDE(Primitive_AuxDataA = D_8006B684);
PROVIDE(Primitive_AuxDataB = D_8006B690);
PROVIDE(Primitive_BaseTable = D_8006B5CC);
PROVIDE(Primitive_CollideFlag = D_8008A838);
PROVIDE(Primitive_FuncTable = D_8006D4AC);
PROVIDE(PrimMusicVtable = D_8006D3C8);
PROVIDE(PrimSfxVtable = D_8006D370);
PROVIDE(Ptr_DreamParticle = D_800873C8);
PROVIDE(Ptr_SecondEntity = D_80087424);
PROVIDE(PTR_StageSecondaryEntityTablePtr = D_800876B4);
PROVIDE(Ptr_Unk88ba4 = D_80088BA4);
PROVIDE(Ptr_Unk88bdc = D_80088BDC);
PROVIDE(Ptr_Unk88c4c = D_80088C4C);
PROVIDE(Ptr_Unk88c84 = D_80088C84);
PROVIDE(SavedInterruptCB = D_8006DC9C);
PROVIDE(Scene_CurrentId = D_8008A8CC);
PROVIDE(Scene_TimelineVtable = D_8006DA34);
PROVIDE(Scene_Vtable = D_8006D940);
PROVIDE(Scene_VtableAlt = D_8006D9BC);
PROVIDE(SecondaryEntityRangeTable = D_80087474);
PROVIDE(Spu_AdpcmPitchTable = D_8006DAD8);
PROVIDE(SpuCurrentBankData = D_8008E970);
PROVIDE(SpuDmaCallbackData1 = D_8006DD00);
PROVIDE(SpuDmaCallbackData2 = D_8006DD04);
PROVIDE(SpuDmaEventId = D_8006DD80);
PROVIDE(SpuFrameCounter = D_8008A8D8);
PROVIDE(SpuInitialized = D_8006E184);
PROVIDE(SpuMasterVolDefaults = D_8006DC6C);
PROVIDE(SpuRegDefaults = D_8006DC5C);
PROVIDE(SpuSeqObjectVtable = D_8006E4F0);
PROVIDE(SpuSeqPlayerVtable = D_8006E48C);
PROVIDE(SpuSeqTrackVtable = D_8006E558);
PROVIDE(SpuSeqTrackVtableB = D_8006E5F8);
PROVIDE(SpuTransferInProgress = D_8006DCFC);
PROVIDE(Stage_AdjDirectionOffsets = D_800868A8);
PROVIDE(Stage_AdjEdgeFlags = D_8008688C);
PROVIDE(Stage_ChunkDataTableVtable = D_80086AA0);
PROVIDE(Stage_ChunkDataVtable = D_800869D8);
PROVIDE(Stage_ChunkSpawnCounts = D_80086170);
PROVIDE(Stage_EntityVtable = D_80086B60);
PROVIDE(Stage_MapChunkVtable = D_800866E8);
PROVIDE(Stage_McDeleteFilename = D_8008AAAC);
PROVIDE(Stage_McEncodingData = D_80011550);
PROVIDE(Stage_McEncodingData2 = D_80011551);
PROVIDE(Stage_McEventStatusResults = D_80086E78);
PROVIDE(Stage_McPathPrefix0 = D_8008AAA4);
PROVIDE(Stage_McPathPrefix1 = D_8008AA9C);
PROVIDE(Stage_McSplitHalfSize = D_8008A97C);
PROVIDE(Stage_McSplitIoState = D_8008A978);
PROVIDE(Stage_MemoryCardVtable = D_80086DC4);
PROVIDE(Stage_NavChallengeBuf = D_8008AA1C);
PROVIDE(Stage_NavChallengeWord1 = D_800114AC);
PROVIDE(Stage_NavChallengeWord2 = D_800114B0);
PROVIDE(Stage_StageChunkVtable = D_800865C8);
PROVIDE(Stage_StageGridVtable = D_80086668);
PROVIDE(Prim_WriteModDiv = func_8004c368);
PROVIDE(Chunk_CalcTileCoord = func_8004c3f0);
PROVIDE(Chunk_FindByType = func_8004c434);
PROVIDE(Chunk_FindByCoord = func_8004c470);
PROVIDE(Chunk_FindIndexByType = func_8004c588);
PROVIDE(Chunk_FindActiveIndex = func_8004c5d0);
PROVIDE(Chunk_RenderDispatch = func_8004c620);
PROVIDE(Chunk_UpdateRenderTransform = func_8004c6a8);
PROVIDE(Chunk_BuildSliceEntries = func_8004c93c);
PROVIDE(Chunk_BuildSliceOverflow = func_8004caf0);
PROVIDE(Chunk_RenderGpu = func_8004cc74);
PROVIDE(Prim_IsPointInRect = func_8004cd38);
PROVIDE(Chunk_SetupRenderSlot = func_8004cda4);
PROVIDE(Chunk_ProcessRenderList = func_8004ce24);
PROVIDE(Chunk_GetFadeArea = func_8004cfa8);
PROVIDE(Chunk_SetFadeValue = func_8004cfb0);
PROVIDE(Chunk_SetupFadeParams = func_8004cfb8);
PROVIDE(Chunk_ApplyFadeTick = func_8004d028);
PROVIDE(Chunk_ResetFade = func_8004d088);
PROVIDE(ChunkData_ApplyFade = func_8004d0d0);
PROVIDE(Chunk_RenderFadeScreen = func_8004d108);
PROVIDE(Chunk_ApplyToAll = func_8004d140);
PROVIDE(Chunk_ApplyToAllEntries = func_8004d1d0);
PROVIDE(Stage_GetChunkVtable = func_8004d244);
PROVIDE(ChunkData_Alloc = func_8004d254);
PROVIDE(ChunkData_Constructor = func_8004d2a4);
PROVIDE(ChunkData_Nop = func_8004d2f8);
PROVIDE(ChunkData_Render = func_8004d300);
PROVIDE(ChunkDataTable_Nop01 = func_8004d35c);
PROVIDE(ChunkDataTable_Nop02 = func_8004d364);
PROVIDE(ChunkDataTable_Nop03 = func_8004d36c);
PROVIDE(ChunkDataTable_Nop04 = func_8004d374);
PROVIDE(Stage_GetChunkDataVtable = func_8004d37c);
PROVIDE(ChunkDataTable_Alloc = func_8004d38c);
PROVIDE(ChunkDataTable_Constructor = func_8004d3dc);
PROVIDE(ChunkDataTable_Nop05 = func_8004d42c);
PROVIDE(ChunkDataTable_CheckChar4 = func_8004d434);
PROVIDE(ChunkDataTable_ProcessInput = func_8004d47c);
PROVIDE(ChunkDataTable_Identity = func_8004d500);
PROVIDE(Stage_GetChunkDataTableVtable = func_8004d508);
PROVIDE(StageEntity_Alloc = func_8004d518);
PROVIDE(StageEntity_Constructor = func_8004d578);
PROVIDE(StageEntity_SetDreamFlag = func_8004d678);
PROVIDE(Stage_SetupChallengeData = func_8004d6ac);
PROVIDE(NavMenu_CloseNav = func_8004d704);
PROVIDE(NavMenu_HandleMessage = func_8004d788);
PROVIDE(NavMenu_InitTitle = func_8004d814);
PROVIDE(NavMenu_DrawAc = func_8004d898);
PROVIDE(NavMenu_HandleState = func_8004d90c);
PROVIDE(NavMenu_Update = func_8004d9d4);
PROVIDE(StageChildObjects = D_8008AB98);
PROVIDE(StageChildTransform = D_8008AB94);
PROVIDE(StageSecondaryEntityCount = D_800876EC);
PROVIDE(SubType0AnimFrameTable = D_8008780C);
PROVIDE(SubType0ColourSetting = D_80087838);
PROVIDE(SubType0OffsetTable = D_800877F8);
PROVIDE(SubType2Colour0 = D_80087868);
PROVIDE(SubType2Colour1 = D_8008785C);
PROVIDE(SubType2Colour2 = D_80087874);
PROVIDE(SubType2StateArray = D_80087844);
PROVIDE(SubType2TempState = D_80087880);
PROVIDE(TimerCallback_Default = D_80033738);
PROVIDE(TimerCallback_SpuSet = D_80032A9C);
PROVIDE(TimerCallback_VSync = D_80032AD0);
PROVIDE(TimerCountUp = D_8006DC94);
PROVIDE(TimerMode = D_8006DC90);
PROVIDE(TimerSpinCounter = D_8006DC8C);
PROVIDE(TriggerAmbientEvent = func_8005cf34);
PROVIDE(Unk_DreamBuf58 = D_80088758);
PROVIDE(Unk_DreamBufF18 = D_80088F18);
PROVIDE(Unk_EntityBuf8C = D_8008788C);
PROVIDE(Unk_EntityBufC8 = D_800871C8);
PROVIDE(Unk_ParticleBuf1C = D_8008721C);
PROVIDE(Unk_ParticleBuf28 = D_80087228);
PROVIDE(Unk_ParticleBufC4 = D_800872C4);
PROVIDE(Unk_SoundBufC4 = D_80089AC4);
PROVIDE(Unk_SpuBuf154 = D_8008E154);
PROVIDE(VideoMode = D_8006DC98);
PROVIDE(Vtable_DreamParticle = D_800876FC);
PROVIDE(Vtable_DreamSymbol = D_80087AAC);
PROVIDE(Vtable_Entity2 = D_80086ED0);
PROVIDE(Vtable_Entity3 = D_80086F88);
PROVIDE(Vtable_Entity4 = D_80087034);
PROVIDE(Vtable_EntitySubObject2 = D_800879C4);

/* Case-matching aliases for Rendering.c functions (auto-generated) */

/* Case-matching aliases for Rendering.c functions (auto-generated) */

/* PROVIDE aliases for stubs.c PascalCase functions */
PROVIDE(func_8001e6f8 = MathReadScaledShorts);
PROVIDE(func_8001E6F8 = MathReadScaledShorts);
PROVIDE(func_8001ef14 = MathIsPointInBox);
PROVIDE(func_8001EF14 = MathIsPointInBox);
PROVIDE(func_8002cc34 = AnimInitializeBase);
PROVIDE(func_8002cd08 = AnimTick);
PROVIDE(func_8002cc84 = AnimReset);
PROVIDE(func_8001e600 = MathTransformByMatrix);
PROVIDE(func_8001E600 = MathTransformByMatrix);
PROVIDE(func_8001ee98 = MathTransformMultipleVectors);
PROVIDE(func_8001EE98 = MathTransformMultipleVectors);
PROVIDE(func_80017a9c = System_HeapInit);
PROVIDE(func_80017A9C = System_HeapInit);
PROVIDE(func_800183a0 = LinkedListPopFront);
PROVIDE(func_800183A0 = LinkedListPopFront);
PROVIDE(func_80018464 = RenderSceneView);
PROVIDE(func_8005cf34 = DreamSys__CinemaDispatch);
PROVIDE(func_8005CF34 = DreamSys__CinemaDispatch);
PROVIDE(func_8005cab4 = DreamSys__TraverseStates);
PROVIDE(func_8005CAB4 = DreamSys__TraverseStates);

/* PROVIDE aliases for functions defined in ref/ files (not compiled) */
/* func_80018390 = GetBasicVtab = vtable getter returning &D_8006B58C (build 0x80081fd4) */
PROVIDE(func_80018390 = GetCoordSystemVtable);
PROVIDE(func_800183dc = ABSOLUTE(0x800183dc));
PROVIDE(func_8001ca94 = ABSOLUTE(0x8001ca94));
PROVIDE(func_8001cba4 = ABSOLUTE(0x8001cba4));
PROVIDE(func_8001cc48 = ABSOLUTE(0x8001cc48));
PROVIDE(func_8001ccb4 = ABSOLUTE(0x8001ccb4));
PROVIDE(func_8001cd20 = ABSOLUTE(0x8001cd20));
PROVIDE(func_8001cd60 = ABSOLUTE(0x8001cd60));
PROVIDE(func_8001ceb4 = ABSOLUTE(0x8001ceb4));
PROVIDE(func_8001d008 = ABSOLUTE(0x8001d008));
PROVIDE(func_8001d0ec = ABSOLUTE(0x8001d0ec));
PROVIDE(func_8001d1a4 = ABSOLUTE(0x8001d1a4));
PROVIDE(func_8001d204 = ABSOLUTE(0x8001d204));
PROVIDE(func_8001d280 = ABSOLUTE(0x8001d280));
PROVIDE(func_8001d33c = ABSOLUTE(0x8001d33c));
PROVIDE(func_8001d344 = ABSOLUTE(0x8001d344));
PROVIDE(func_8001d374 = ABSOLUTE(0x8001d374));
PROVIDE(func_8001d3a0 = ABSOLUTE(0x8001d3a0));
PROVIDE(func_8001d3cc = ABSOLUTE(0x8001d3cc));
PROVIDE(func_8001d3f8 = ABSOLUTE(0x8001d3f8));
PROVIDE(func_8001d424 = ABSOLUTE(0x8001d424));
PROVIDE(func_8001d450 = ABSOLUTE(0x8001d450));
PROVIDE(func_8001d480 = ABSOLUTE(0x8001d480));
PROVIDE(func_8001d4ac = ABSOLUTE(0x8001d4ac));
PROVIDE(func_8001d4dc = ABSOLUTE(0x8001d4dc));
PROVIDE(func_8001d568 = ABSOLUTE(0x8001d568));
PROVIDE(func_8001d600 = ABSOLUTE(0x8001d600));
PROVIDE(func_8001d624 = ABSOLUTE(0x8001d624));
PROVIDE(func_8001d6a4 = ABSOLUTE(0x8001d6a4));
PROVIDE(func_8001d6ac = ABSOLUTE(0x8001d6ac));
PROVIDE(func_8001d6b4 = ABSOLUTE(0x8001d6b4));
PROVIDE(func_8001d714 = ABSOLUTE(0x8001d714));
PROVIDE(func_8001d950 = ABSOLUTE(0x8001d950));
PROVIDE(func_8001da28 = ABSOLUTE(0x8001da28));
PROVIDE(func_8001ddf4 = ABSOLUTE(0x8001ddf4));
PROVIDE(func_8001e110 = ABSOLUTE(0x8001e110));
PROVIDE(func_8001e2e8 = ABSOLUTE(0x8001e2e8));
PROVIDE(func_8001E2E8 = ABSOLUTE(0x8001E2E8));
PROVIDE(func_8001e49c = ABSOLUTE(0x8001e49c));
PROVIDE(func_8001e4a4 = ABSOLUTE(0x8001e4a4));
PROVIDE(func_8001e58c = ABSOLUTE(0x8001e58c));
PROVIDE(func_8001e770 = ABSOLUTE(0x8001e770));
PROVIDE(func_8001e7b0 = ABSOLUTE(0x8001e7b0));
PROVIDE(func_8001e7bc = ABSOLUTE(0x8001e7bc));
PROVIDE(func_8001ea8c = ABSOLUTE(0x8001ea8c));
PROVIDE(func_8001eacc = ABSOLUTE(0x8001eacc));
PROVIDE(func_8001ecfc = ABSOLUTE(0x8001ecfc));
PROVIDE(func_8001edac = ABSOLUTE(0x8001edac));
PROVIDE(func_8001ee04 = ABSOLUTE(0x8001ee04));
PROVIDE(func_8001ef60 = ABSOLUTE(0x8001ef60));
PROVIDE(func_8001ef70 = ABSOLUTE(0x8001ef70));
PROVIDE(func_8001f0c8 = ABSOLUTE(0x8001f0c8));
PROVIDE(func_8001f250 = ABSOLUTE(0x8001f250));
PROVIDE(func_8001f2b0 = ABSOLUTE(0x8001f2b0));
PROVIDE(func_8001f314 = ABSOLUTE(0x8001f314));
PROVIDE(func_8001f33c = ABSOLUTE(0x8001f33c));
PROVIDE(func_8001f360 = ABSOLUTE(0x8001f360));
PROVIDE(func_8001f37c = ABSOLUTE(0x8001f37c));
PROVIDE(func_8001f384 = ABSOLUTE(0x8001f384));
PROVIDE(func_8001f394 = ABSOLUTE(0x8001f394));
PROVIDE(func_8001f3a4 = ABSOLUTE(0x8001f3a4));
PROVIDE(func_8001f3b0 = ABSOLUTE(0x8001f3b0));
PROVIDE(func_8001f4e4 = ABSOLUTE(0x8001f4e4));
PROVIDE(func_8001f50c = ABSOLUTE(0x8001f50c));
PROVIDE(func_8001f51c = ABSOLUTE(0x8001f51c));
PROVIDE(func_8001f66c = ABSOLUTE(0x8001f66c));
PROVIDE(func_8001f8b8 = ABSOLUTE(0x8001f8b8));
PROVIDE(func_8001F8B8 = ABSOLUTE(0x8001F8B8));
PROVIDE(func_80020050 = ABSOLUTE(0x80020050));
PROVIDE(func_800204d0 = ABSOLUTE(0x800204d0));
PROVIDE(func_80020548 = ABSOLUTE(0x80020548));
PROVIDE(func_800205c0 = ABSOLUTE(0x800205c0));
PROVIDE(func_80020644 = ABSOLUTE(0x80020644));

PROVIDE(func_80020730 = ABSOLUTE(0x80020730));
PROVIDE(func_80020784 = ABSOLUTE(0x80020784));
PROVIDE(func_800207dc = ABSOLUTE(0x800207dc));
PROVIDE(func_8002085c = ABSOLUTE(0x8002085c));
PROVIDE(func_8002089c = ABSOLUTE(0x8002089c));
PROVIDE(func_800208b8 = ABSOLUTE(0x800208b8));
PROVIDE(func_800208d8 = ABSOLUTE(0x800208d8));
PROVIDE(func_800208f8 = ABSOLUTE(0x800208f8));
PROVIDE(func_80020970 = ABSOLUTE(0x80020970));
PROVIDE(func_800209a0 = ABSOLUTE(0x800209a0));
PROVIDE(func_80020a1c = ABSOLUTE(0x80020a1c));
PROVIDE(func_80020a24 = ABSOLUTE(0x80020a24));
PROVIDE(func_80020a74 = ABSOLUTE(0x80020a74));
PROVIDE(func_80020af4 = ABSOLUTE(0x80020af4));
PROVIDE(func_80020b4c = ABSOLUTE(0x80020b4c));
PROVIDE(func_80020b68 = ABSOLUTE(0x80020b68));
PROVIDE(func_80020b74 = ABSOLUTE(0x80020b74));
PROVIDE(func_80020c08 = ABSOLUTE(0x80020c08));
PROVIDE(func_80020c3c = ABSOLUTE(0x80020c3c));
PROVIDE(func_80020c44 = ABSOLUTE(0x80020c44));
PROVIDE(func_80020c4c = ABSOLUTE(0x80020c4c));
PROVIDE(func_80020c5c = ABSOLUTE(0x80020c5c));
PROVIDE(func_80020c68 = ABSOLUTE(0x80020c68));
PROVIDE(func_80020c74 = ABSOLUTE(0x80020c74));
PROVIDE(func_80020dd0 = ABSOLUTE(0x80020dd0));
PROVIDE(func_80020ee4 = ABSOLUTE(0x80020ee4));
PROVIDE(func_80020f50 = ABSOLUTE(0x80020f50));
PROVIDE(func_80020ffc = ABSOLUTE(0x80020ffc));
PROVIDE(func_8002100c = ABSOLUTE(0x8002100c));
PROVIDE(func_8002101c = ABSOLUTE(0x8002101c));
PROVIDE(func_80021078 = ABSOLUTE(0x80021078));
PROVIDE(func_80021114 = ABSOLUTE(0x80021114));
PROVIDE(func_80021180 = ABSOLUTE(0x80021180));
PROVIDE(func_800212a8 = ABSOLUTE(0x800212a8));
PROVIDE(func_8002133c = ABSOLUTE(0x8002133c));
PROVIDE(func_800213a0 = ABSOLUTE(0x800213a0));
PROVIDE(func_80021404 = ABSOLUTE(0x80021404));
PROVIDE(func_800214c8 = ABSOLUTE(0x800214c8));
PROVIDE(func_80021580 = ABSOLUTE(0x80021580));
PROVIDE(func_80021618 = ABSOLUTE(0x80021618));
PROVIDE(func_80021678 = ABSOLUTE(0x80021678));
PROVIDE(func_800216ec = ABSOLUTE(0x800216ec));
PROVIDE(func_800217b0 = ABSOLUTE(0x800217b0));
PROVIDE(func_800217e8 = ABSOLUTE(0x800217e8));
PROVIDE(func_80021c0c = ABSOLUTE(0x80021c0c));
PROVIDE(func_80021c44 = ABSOLUTE(0x80021c44));
PROVIDE(func_80021c78 = ABSOLUTE(0x80021c78));
PROVIDE(func_80021cb4 = ABSOLUTE(0x80021cb4));
PROVIDE(func_80021d38 = ABSOLUTE(0x80021d38));
PROVIDE(func_80021d7c = ABSOLUTE(0x80021d7c));
PROVIDE(func_80021da4 = ABSOLUTE(0x80021da4));
PROVIDE(func_80021dfc = ABSOLUTE(0x80021dfc));
PROVIDE(func_800220a0 = ABSOLUTE(0x800220a0));
PROVIDE(func_800220fc = ABSOLUTE(0x800220fc));
PROVIDE(func_800221c8 = ABSOLUTE(0x800221c8));
PROVIDE(func_80022294 = ABSOLUTE(0x80022294));
PROVIDE(func_800222dc = ABSOLUTE(0x800222dc));
PROVIDE(func_80022360 = ABSOLUTE(0x80022360));
PROVIDE(func_8002241c = ABSOLUTE(0x8002241c));
PROVIDE(func_80022434 = ABSOLUTE(0x80022434));
PROVIDE(func_8002251c = ABSOLUTE(0x8002251c));
PROVIDE(func_8002273c = ABSOLUTE(0x8002273c));
PROVIDE(func_80022990 = ABSOLUTE(0x80022990));
PROVIDE(func_80022c2c = ABSOLUTE(0x80022c2c));
PROVIDE(func_80022c58 = ABSOLUTE(0x80022c58));
PROVIDE(func_80022c70 = ABSOLUTE(0x80022c70));
PROVIDE(func_80022cc0 = ABSOLUTE(0x80022cc0));
PROVIDE(func_80022d0c = ABSOLUTE(0x80022d0c));
PROVIDE(func_80022d3c = ABSOLUTE(0x80022d3c));
PROVIDE(func_80022d60 = ABSOLUTE(0x80022d60));
PROVIDE(func_80023054 = ABSOLUTE(0x80023054));
PROVIDE(func_80023368 = ABSOLUTE(0x80023368));
PROVIDE(func_800234a4 = ABSOLUTE(0x800234a4));
PROVIDE(func_800235ec = ABSOLUTE(0x800235ec));
PROVIDE(func_80023620 = ABSOLUTE(0x80023620));
PROVIDE(func_8002378c = ABSOLUTE(0x8002378c));
PROVIDE(func_8002386c = ABSOLUTE(0x8002386c));
PROVIDE(func_80023898 = ABSOLUTE(0x80023898));
PROVIDE(func_800238a8 = ABSOLUTE(0x800238a8));
PROVIDE(func_800238dc = ABSOLUTE(0x800238dc));
PROVIDE(func_80023954 = ABSOLUTE(0x80023954));
PROVIDE(func_80023aac = ABSOLUTE(0x80023aac));
PROVIDE(func_80023b24 = ABSOLUTE(0x80023b24));
PROVIDE(func_80023da0 = ABSOLUTE(0x80023da0));
PROVIDE(func_80023f08 = ABSOLUTE(0x80023f08));
PROVIDE(func_80023fd0 = ABSOLUTE(0x80023fd0));
PROVIDE(func_80023fe8 = ABSOLUTE(0x80023fe8));
PROVIDE(func_800240b8 = ABSOLUTE(0x800240b8));
PROVIDE(func_800240f8 = ABSOLUTE(0x800240f8));
PROVIDE(func_80024114 = ABSOLUTE(0x80024114));
PROVIDE(func_80024130 = ABSOLUTE(0x80024130));
PROVIDE(func_8002416c = ABSOLUTE(0x8002416c));
PROVIDE(func_800241a8 = ABSOLUTE(0x800241a8));
PROVIDE(func_800241cc = ABSOLUTE(0x800241cc));
PROVIDE(func_800241e4 = ABSOLUTE(0x800241e4));
PROVIDE(func_8002420c = ABSOLUTE(0x8002420c));
PROVIDE(func_80024234 = ABSOLUTE(0x80024234));
PROVIDE(func_80024248 = ABSOLUTE(0x80024248));
PROVIDE(func_8002425c = ABSOLUTE(0x8002425c));
PROVIDE(func_80024270 = ABSOLUTE(0x80024270));
PROVIDE(func_80024284 = ABSOLUTE(0x80024284));
PROVIDE(func_80024298 = ABSOLUTE(0x80024298));
PROVIDE(func_800242ac = ABSOLUTE(0x800242ac));
PROVIDE(func_800242c0 = ABSOLUTE(0x800242c0));
PROVIDE(func_800242d4 = ABSOLUTE(0x800242d4));
PROVIDE(func_800242e8 = ABSOLUTE(0x800242e8));
PROVIDE(func_800242fc = ABSOLUTE(0x800242fc));
PROVIDE(func_80024310 = ABSOLUTE(0x80024310));
PROVIDE(func_80024324 = ABSOLUTE(0x80024324));
PROVIDE(func_80024338 = ABSOLUTE(0x80024338));
PROVIDE(func_8002434c = ABSOLUTE(0x8002434c));
PROVIDE(func_80024360 = ABSOLUTE(0x80024360));
PROVIDE(func_80024374 = ABSOLUTE(0x80024374));
PROVIDE(func_80024388 = ABSOLUTE(0x80024388));
PROVIDE(func_800243a8 = ABSOLUTE(0x800243a8));
PROVIDE(func_800243c8 = ABSOLUTE(0x800243c8));
PROVIDE(func_800243e8 = ABSOLUTE(0x800243e8));
PROVIDE(func_80024408 = ABSOLUTE(0x80024408));
PROVIDE(func_8002441c = ABSOLUTE(0x8002441c));
PROVIDE(func_80024438 = ABSOLUTE(0x80024438));
PROVIDE(func_80024470 = ABSOLUTE(0x80024470));
PROVIDE(func_800245f0 = ABSOLUTE(0x800245f0));
PROVIDE(func_8002469c = ABSOLUTE(0x8002469c));
PROVIDE(func_80024734 = ABSOLUTE(0x80024734));
PROVIDE(func_800247d4 = ABSOLUTE(0x800247d4));
PROVIDE(func_80024820 = ABSOLUTE(0x80024820));
PROVIDE(func_80024830 = ABSOLUTE(0x80024830));
PROVIDE(func_8002494c = ABSOLUTE(0x8002494c));
PROVIDE(func_80024a40 = ABSOLUTE(0x80024a40));
PROVIDE(func_80024a50 = ABSOLUTE(0x80024a50));
PROVIDE(func_80024a60 = ABSOLUTE(0x80024a60));
PROVIDE(func_80024a70 = ABSOLUTE(0x80024a70));
PROVIDE(func_80024a90 = ABSOLUTE(0x80024a90));
PROVIDE(func_80024aa4 = ABSOLUTE(0x80024aa4));
PROVIDE(func_80024ab8 = ABSOLUTE(0x80024ab8));
PROVIDE(func_80024ac4 = ABSOLUTE(0x80024ac4));
PROVIDE(func_80024ae4 = ABSOLUTE(0x80024ae4));
PROVIDE(func_80024b04 = ABSOLUTE(0x80024b04));
PROVIDE(func_80024b18 = ABSOLUTE(0x80024b18));
PROVIDE(func_80024b30 = ABSOLUTE(0x80024b30));
PROVIDE(func_80024b44 = ABSOLUTE(0x80024b44));
PROVIDE(func_80024b58 = ABSOLUTE(0x80024b58));
PROVIDE(func_80024b6c = ABSOLUTE(0x80024b6c));
PROVIDE(func_80024b78 = ABSOLUTE(0x80024b78));
PROVIDE(func_80024b90 = ABSOLUTE(0x80024b90));
PROVIDE(func_80024b9c = ABSOLUTE(0x80024b9c));
PROVIDE(func_80024ba8 = ABSOLUTE(0x80024ba8));
PROVIDE(func_80024bc0 = ABSOLUTE(0x80024bc0));
PROVIDE(func_80024c40 = ABSOLUTE(0x80024c40));
PROVIDE(func_80024cb0 = ABSOLUTE(0x80024cb0));
PROVIDE(func_80024ce0 = ABSOLUTE(0x80024ce0));
PROVIDE(func_80024cf0 = ABSOLUTE(0x80024cf0));
PROVIDE(func_80024d00 = ABSOLUTE(0x80024d00));
PROVIDE(func_80024d10 = ABSOLUTE(0x80024d10));
PROVIDE(func_80024d40 = ABSOLUTE(0x80024d40));
PROVIDE(func_80024d70 = ABSOLUTE(0x80024d70));
PROVIDE(func_80024da0 = ABSOLUTE(0x80024da0));
PROVIDE(func_80024dd4 = ABSOLUTE(0x80024dd4));
PROVIDE(func_80024e04 = ABSOLUTE(0x80024e04));
PROVIDE(func_80024e34 = ABSOLUTE(0x80024e34));
PROVIDE(func_80024e64 = ABSOLUTE(0x80024e64));
PROVIDE(func_80024e74 = ABSOLUTE(0x80024e74));
PROVIDE(func_80024e8c = ABSOLUTE(0x80024e8c));
PROVIDE(func_80024ea8 = ABSOLUTE(0x80024ea8));
PROVIDE(func_80024f84 = ABSOLUTE(0x80024f84));
PROVIDE(func_8002516c = ABSOLUTE(0x8002516c));
PROVIDE(func_800252c0 = ABSOLUTE(0x800252c0));
PROVIDE(func_80025370 = ABSOLUTE(0x80025370));
PROVIDE(func_800253f8 = ABSOLUTE(0x800253f8));
PROVIDE(func_80025424 = ABSOLUTE(0x80025424));
PROVIDE(func_80025434 = ABSOLUTE(0x80025434));
PROVIDE(func_80025444 = ABSOLUTE(0x80025444));
PROVIDE(func_80025454 = ABSOLUTE(0x80025454));
PROVIDE(func_80025464 = ABSOLUTE(0x80025464));
PROVIDE(func_80025474 = ABSOLUTE(0x80025474));
PROVIDE(func_80025484 = ABSOLUTE(0x80025484));
PROVIDE(func_800254c0 = ABSOLUTE(0x800254c0));
PROVIDE(func_80025504 = ABSOLUTE(0x80025504));
PROVIDE(func_8002551c = ABSOLUTE(0x8002551c));
PROVIDE(func_8002552c = ABSOLUTE(0x8002552c));
PROVIDE(func_8002557c = ABSOLUTE(0x8002557c));
PROVIDE(func_80025700 = ABSOLUTE(0x80025700));
PROVIDE(func_800257a8 = ABSOLUTE(0x800257a8));
PROVIDE(func_800257d4 = ABSOLUTE(0x800257d4));
PROVIDE(func_8002582c = ABSOLUTE(0x8002582c));
PROVIDE(func_800258a8 = ABSOLUTE(0x800258a8));
PROVIDE(func_800258d4 = ABSOLUTE(0x800258d4));
PROVIDE(func_80025900 = ABSOLUTE(0x80025900));
PROVIDE(func_80025a48 = ABSOLUTE(0x80025a48));
PROVIDE(func_80025ae4 = ABSOLUTE(0x80025ae4));
PROVIDE(func_80025e9c = ABSOLUTE(0x80025e9c));
PROVIDE(func_80025eac = ABSOLUTE(0x80025eac));
PROVIDE(func_80025efc = ABSOLUTE(0x80025efc));
PROVIDE(func_80025f2c = ABSOLUTE(0x80025f2c));
PROVIDE(func_80025f4c = ABSOLUTE(0x80025f4c));
PROVIDE(func_80025f5c = ABSOLUTE(0x80025f5c));
PROVIDE(func_80025f6c = ABSOLUTE(0x80025f6c));
PROVIDE(func_800270b8 = ABSOLUTE(0x800270b8));
PROVIDE(func_8002c480 = ABSOLUTE(0x8002c480));
PROVIDE(func_8003069c = ABSOLUTE(0x8003069c));
PROVIDE(func_80035e80 = ABSOLUTE(0x80035e80));
PROVIDE(func_80036ac8 = ABSOLUTE(0x80036ac8));
PROVIDE(func_80036b20 = ABSOLUTE(0x80036b20));
PROVIDE(func_80037030 = ABSOLUTE(0x80037030));
PROVIDE(func_80037500 = ABSOLUTE(0x80037500));
PROVIDE(func_80037570 = ABSOLUTE(0x80037570));
PROVIDE(func_800375e8 = ABSOLUTE(0x800375e8));
PROVIDE(func_8003760c = ABSOLUTE(0x8003760c));
PROVIDE(func_800379a0 = ABSOLUTE(0x800379a0));
PROVIDE(func_80037a30 = ABSOLUTE(0x80037a30));
PROVIDE(func_80037f78 = ABSOLUTE(0x80037f78));
PROVIDE(func_800382bc = ABSOLUTE(0x800382bc));
PROVIDE(func_80038468 = ABSOLUTE(0x80038468));
PROVIDE(func_80038658 = ABSOLUTE(0x80038658));
PROVIDE(func_80038900 = ABSOLUTE(0x80038900));
PROVIDE(func_80038988 = ABSOLUTE(0x80038988));
PROVIDE(func_800389f0 = ABSOLUTE(0x800389f0));
PROVIDE(func_80038a38 = ABSOLUTE(0x80038a38));
PROVIDE(func_80038adc = ABSOLUTE(0x80038adc));
PROVIDE(func_80038b18 = ABSOLUTE(0x80038b18));
PROVIDE(func_80038b28 = ABSOLUTE(0x80038b28));
PROVIDE(func_80038cc8 = ABSOLUTE(0x80038cc8));
PROVIDE(func_80038cd8 = ABSOLUTE(0x80038cd8));
PROVIDE(func_80038d54 = ABSOLUTE(0x80038d54));
PROVIDE(func_80038d74 = ABSOLUTE(0x80038d74));
PROVIDE(func_80038e44 = ABSOLUTE(0x80038e44));
PROVIDE(func_80038ee8 = ABSOLUTE(0x80038ee8));
PROVIDE(func_80038f6c = ABSOLUTE(0x80038f6c));
PROVIDE(func_80038f7c = ABSOLUTE(0x80038f7c));
PROVIDE(func_80038f8c = ABSOLUTE(0x80038f8c));
PROVIDE(func_80038fb0 = ABSOLUTE(0x80038fb0));
PROVIDE(func_8003902c = ABSOLUTE(0x8003902c));
PROVIDE(func_8003903c = ABSOLUTE(0x8003903c));
PROVIDE(func_8003904c = ABSOLUTE(0x8003904c));
PROVIDE(func_800390f4 = ABSOLUTE(0x800390f4));
PROVIDE(func_80039104 = ABSOLUTE(0x80039104));
PROVIDE(func_80039158 = ABSOLUTE(0x80039158));
PROVIDE(func_8003918c = ABSOLUTE(0x8003918c));
PROVIDE(func_800391c8 = ABSOLUTE(0x800391c8));
PROVIDE(func_80039228 = ABSOLUTE(0x80039228));
PROVIDE(func_80039254 = ABSOLUTE(0x80039254));
PROVIDE(func_80039264 = ABSOLUTE(0x80039264));
PROVIDE(func_8003952c = ABSOLUTE(0x8003952c));
PROVIDE(func_8003982c = ABSOLUTE(0x8003982c));
PROVIDE(func_8003995c = ABSOLUTE(0x8003995c));
PROVIDE(func_80039a34 = ABSOLUTE(0x80039a34));
PROVIDE(func_80039b04 = ABSOLUTE(0x80039b04));
PROVIDE(func_80039b90 = ABSOLUTE(0x80039b90));
PROVIDE(func_80039c04 = ABSOLUTE(0x80039c04));
PROVIDE(func_80039cbc = ABSOLUTE(0x80039cbc));
PROVIDE(func_80039d14 = ABSOLUTE(0x80039d14));
PROVIDE(func_80039d68 = ABSOLUTE(0x80039d68));
PROVIDE(func_80039db0 = ABSOLUTE(0x80039db0));
PROVIDE(func_80039df4 = ABSOLUTE(0x80039df4));
PROVIDE(func_80039e24 = ABSOLUTE(0x80039e24));
PROVIDE(func_80039e7c = ABSOLUTE(0x80039e7c));
PROVIDE(func_80039f64 = ABSOLUTE(0x80039f64));
PROVIDE(func_8003a04c = ABSOLUTE(0x8003a04c));
PROVIDE(func_8003a05c = ABSOLUTE(0x8003a05c));
PROVIDE(func_8003a068 = ABSOLUTE(0x8003a068));
PROVIDE(func_8003a078 = ABSOLUTE(0x8003a078));
PROVIDE(func_8003a0b0 = ABSOLUTE(0x8003a0b0));
PROVIDE(func_8003a0e0 = ABSOLUTE(0x8003a0e0));
PROVIDE(func_8003a118 = ABSOLUTE(0x8003a118));
PROVIDE(func_8003a14c = ABSOLUTE(0x8003a14c));
PROVIDE(func_8003a1f0 = ABSOLUTE(0x8003a1f0));
PROVIDE(func_8003a218 = ABSOLUTE(0x8003a218));
PROVIDE(func_8003a244 = ABSOLUTE(0x8003a244));
PROVIDE(func_8003a318 = ABSOLUTE(0x8003a318));
PROVIDE(func_8003a45c = ABSOLUTE(0x8003a45c));
PROVIDE(func_8003a490 = ABSOLUTE(0x8003a490));
PROVIDE(func_8003a4c4 = ABSOLUTE(0x8003a4c4));
PROVIDE(func_8003a608 = ABSOLUTE(0x8003a608));
PROVIDE(func_8003a63c = ABSOLUTE(0x8003a63c));
PROVIDE(func_8003a670 = ABSOLUTE(0x8003a670));
PROVIDE(func_8003a99c = ABSOLUTE(0x8003a99c));
PROVIDE(func_8003aa68 = ABSOLUTE(0x8003aa68));
PROVIDE(func_8003ab68 = ABSOLUTE(0x8003ab68));
PROVIDE(func_8003aba0 = ABSOLUTE(0x8003aba0));
PROVIDE(func_8003abd8 = ABSOLUTE(0x8003abd8));
PROVIDE(func_8003ac9c = ABSOLUTE(0x8003ac9c));
PROVIDE(func_8003ae18 = ABSOLUTE(0x8003ae18));
PROVIDE(func_8003ae3c = ABSOLUTE(0x8003ae3c));
PROVIDE(func_8003ae60 = ABSOLUTE(0x8003ae60));
PROVIDE(func_8003af38 = ABSOLUTE(0x8003af38));
PROVIDE(func_8003af60 = ABSOLUTE(0x8003af60));
PROVIDE(func_8003af8c = ABSOLUTE(0x8003af8c));
PROVIDE(func_8003b024 = ABSOLUTE(0x8003b024));
PROVIDE(func_8003b02c = ABSOLUTE(0x8003b02c));
PROVIDE(func_8003b044 = ABSOLUTE(0x8003b044));
PROVIDE(func_8003b108 = ABSOLUTE(0x8003b108));
PROVIDE(func_8003b110 = ABSOLUTE(0x8003b110));
PROVIDE(func_8003b20c = ABSOLUTE(0x8003b20c));
/* Case-mismatch aliases for vtable function pointers (uppercase refs in .data.s -> lowercase defs) */
PROVIDE(func_8003AF8C = func_8003af8c);
PROVIDE(func_8003B024 = func_8003b024);
PROVIDE(func_8003B02C = func_8003b02c);
PROVIDE(func_8003B044 = func_8003b044);
PROVIDE(func_8003B108 = func_8003b108);
PROVIDE(func_8003B110 = func_8003b110);
PROVIDE(func_8003B614 = func_8003b614);
PROVIDE(func_800423F0 = func_800423f0);
PROVIDE(func_80043B78 = func_80043b78);
PROVIDE(func_80043E74 = func_80043e74);
PROVIDE(func_800441A4 = func_800441a4);
PROVIDE(func_800449FC = func_800449fc);
PROVIDE(func_80044CC4 = func_80044cc4);
PROVIDE(func_80044F20 = func_80044f20);
PROVIDE(func_800451A8 = func_800451a8);
PROVIDE(func_80048CE0 = func_80048ce0);
PROVIDE(func_800260A4 = NopSub_260a4);
PROVIDE(func_80026108 = NopSub_26108);
PROVIDE(func_80026170 = EntityBehavior_State_80026170);
PROVIDE(func_80026348 = EntityBehavior_State_80026348);
PROVIDE(func_8003b21c = ABSOLUTE(0x8003b21c));
PROVIDE(func_8003b294 = ABSOLUTE(0x8003b294));
PROVIDE(func_8003b324 = ABSOLUTE(0x8003b324));
PROVIDE(func_8003b34c = ABSOLUTE(0x8003b34c));
PROVIDE(func_8003b374 = ABSOLUTE(0x8003b374));
PROVIDE(func_8003b3fc = ABSOLUTE(0x8003b3fc));
PROVIDE(func_8003b470 = ABSOLUTE(0x8003b470));
PROVIDE(func_8003b4a8 = ABSOLUTE(0x8003b4a8));
PROVIDE(func_8003b5ac = ABSOLUTE(0x8003b5ac));
PROVIDE(func_8003b5b4 = ABSOLUTE(0x8003b5b4));
PROVIDE(func_8003b5bc = ABSOLUTE(0x8003b5bc));
PROVIDE(func_8003b5c4 = ABSOLUTE(0x8003b5c4));
PROVIDE(func_8003b5cc = ABSOLUTE(0x8003b5cc));
PROVIDE(func_8003b5d4 = ABSOLUTE(0x8003b5d4));
PROVIDE(func_8003b5dc = ABSOLUTE(0x8003b5dc));
PROVIDE(func_8003b5e4 = ABSOLUTE(0x8003b5e4));
PROVIDE(func_8003b5f0 = ABSOLUTE(0x8003b5f0));
PROVIDE(func_8003b614 = ABSOLUTE(0x8003b614));
PROVIDE(func_8003b770 = ABSOLUTE(0x8003b770));
PROVIDE(func_8003FDB0 = ABSOLUTE(0x8003FDB0));
PROVIDE(func_800411a8 = ABSOLUTE(0x800411a8));
PROVIDE(func_800411e8 = ABSOLUTE(0x800411e8));
PROVIDE(func_80041a48 = ABSOLUTE(0x80041a48));
PROVIDE(func_80041b20 = ABSOLUTE(0x80041b20));
PROVIDE(func_80041bac = ABSOLUTE(0x80041bac));
PROVIDE(func_80041bdc = ABSOLUTE(0x80041bdc));
PROVIDE(func_80041c28 = ABSOLUTE(0x80041c28));
PROVIDE(func_80041c4c = ABSOLUTE(0x80041c4c));
PROVIDE(func_80041d18 = ABSOLUTE(0x80041d18));
PROVIDE(func_80041da4 = ABSOLUTE(0x80041da4));
PROVIDE(func_80041dac = ABSOLUTE(0x80041dac));
PROVIDE(func_80041e2c = ABSOLUTE(0x80041e2c));
PROVIDE(func_80041e58 = ABSOLUTE(0x80041e58));
PROVIDE(func_80041ed8 = ABSOLUTE(0x80041ed8));
PROVIDE(func_80041ee8 = ABSOLUTE(0x80041ee8));
PROVIDE(func_80041f88 = ABSOLUTE(0x80041f88));
PROVIDE(func_8004202c = ABSOLUTE(0x8004202c));
PROVIDE(func_8004208c = ABSOLUTE(0x8004208c));
PROVIDE(func_80042170 = ABSOLUTE(0x80042170));
PROVIDE(func_8004220c = ABSOLUTE(0x8004220c));
PROVIDE(func_8004223c = ABSOLUTE(0x8004223c));
PROVIDE(func_80042268 = ABSOLUTE(0x80042268));
PROVIDE(func_80042294 = ABSOLUTE(0x80042294));
PROVIDE(func_8004229c = ABSOLUTE(0x8004229c));
PROVIDE(func_800422cc = ABSOLUTE(0x800422cc));
PROVIDE(func_8004232c = ABSOLUTE(0x8004232c));
PROVIDE(func_800423a8 = ABSOLUTE(0x800423a8));
PROVIDE(func_800423e4 = ABSOLUTE(0x800423e4));
PROVIDE(func_800423f0 = ABSOLUTE(0x800423f0));
PROVIDE(func_80042450 = ABSOLUTE(0x80042450));
PROVIDE(func_800424a8 = ABSOLUTE(0x800424a8));
PROVIDE(func_800424e0 = ABSOLUTE(0x800424e0));
PROVIDE(func_80042550 = ABSOLUTE(0x80042550));
PROVIDE(func_800425d8 = ABSOLUTE(0x800425d8));
PROVIDE(func_800425ec = ABSOLUTE(0x800425ec));
PROVIDE(func_8004264c = ABSOLUTE(0x8004264c));
PROVIDE(func_80042658 = ABSOLUTE(0x80042658));
PROVIDE(func_80042664 = ABSOLUTE(0x80042664));
PROVIDE(func_8004266c = ABSOLUTE(0x8004266c));
PROVIDE(func_80042678 = ABSOLUTE(0x80042678));
PROVIDE(func_80042684 = ABSOLUTE(0x80042684));
PROVIDE(func_800426e4 = ABSOLUTE(0x800426e4));
PROVIDE(func_80042790 = ABSOLUTE(0x80042790));
PROVIDE(func_80042814 = ABSOLUTE(0x80042814));
PROVIDE(func_80042820 = ABSOLUTE(0x80042820));
PROVIDE(func_80042828 = ABSOLUTE(0x80042828));
PROVIDE(func_8004283c = ABSOLUTE(0x8004283c));
PROVIDE(func_800428f4 = ABSOLUTE(0x800428f4));
PROVIDE(func_8004291c = ABSOLUTE(0x8004291c));
PROVIDE(func_8004297c = ABSOLUTE(0x8004297c));
PROVIDE(func_800429e0 = ABSOLUTE(0x800429e0));
PROVIDE(func_800429e8 = ABSOLUTE(0x800429e8));
PROVIDE(func_80042a2c = ABSOLUTE(0x80042a2c));
PROVIDE(func_80042a7c = ABSOLUTE(0x80042a7c));
PROVIDE(func_80042a8c = ABSOLUTE(0x80042a8c));
PROVIDE(func_80042f50 = ABSOLUTE(0x80042f50));
PROVIDE(func_80042fb8 = ABSOLUTE(0x80042fb8));
PROVIDE(func_80043068 = ABSOLUTE(0x80043068));
PROVIDE(func_800431a8 = ABSOLUTE(0x800431a8));
PROVIDE(func_80043200 = ABSOLUTE(0x80043200));
PROVIDE(func_800434dc = ABSOLUTE(0x800434dc));
PROVIDE(func_80043538 = ABSOLUTE(0x80043538));
PROVIDE(func_8004355c = ABSOLUTE(0x8004355c));
PROVIDE(func_800435d0 = ABSOLUTE(0x800435d0));
PROVIDE(func_80043648 = ABSOLUTE(0x80043648));
PROVIDE(func_80043830 = ABSOLUTE(0x80043830));
PROVIDE(func_800438b0 = ABSOLUTE(0x800438b0));
PROVIDE(func_80043954 = ABSOLUTE(0x80043954));
PROVIDE(func_800439ec = ABSOLUTE(0x800439ec));
PROVIDE(func_80043b18 = ABSOLUTE(0x80043b18));
PROVIDE(func_80043b3c = ABSOLUTE(0x80043b3c));
PROVIDE(func_80043b58 = ABSOLUTE(0x80043b58));
PROVIDE(func_80043b70 = ABSOLUTE(0x80043b70));
PROVIDE(func_80043b78 = ABSOLUTE(0x80043b78));
PROVIDE(func_80043b88 = ABSOLUTE(0x80043b88));
PROVIDE(func_80043be8 = ABSOLUTE(0x80043be8));
PROVIDE(func_80043c60 = ABSOLUTE(0x80043c60));
PROVIDE(func_80043cb8 = ABSOLUTE(0x80043cb8));
PROVIDE(func_80043dfc = ABSOLUTE(0x80043dfc));
PROVIDE(func_80043e74 = ABSOLUTE(0x80043e74));
PROVIDE(func_80043e84 = ABSOLUTE(0x80043e84));
PROVIDE(func_80043ee4 = ABSOLUTE(0x80043ee4));
PROVIDE(func_80043f78 = ABSOLUTE(0x80043f78));
PROVIDE(func_80043fb0 = ABSOLUTE(0x80043fb0));
PROVIDE(func_80043fe4 = ABSOLUTE(0x80043fe4));
PROVIDE(func_8004416c = ABSOLUTE(0x8004416c));
PROVIDE(func_800441a4 = ABSOLUTE(0x800441a4));
PROVIDE(func_80044220 = ABSOLUTE(0x80044220));
PROVIDE(func_80044294 = ABSOLUTE(0x80044294));
PROVIDE(func_80044380 = ABSOLUTE(0x80044380));
PROVIDE(func_8004441c = ABSOLUTE(0x8004441c));
PROVIDE(func_8004464c = ABSOLUTE(0x8004464c));
PROVIDE(func_80044674 = ABSOLUTE(0x80044674));
PROVIDE(func_8004467c = ABSOLUTE(0x8004467c));
PROVIDE(func_800446fc = ABSOLUTE(0x800446fc));
PROVIDE(func_800447b4 = ABSOLUTE(0x800447b4));
PROVIDE(func_80044808 = ABSOLUTE(0x80044808));
PROVIDE(func_80044858 = ABSOLUTE(0x80044858));
PROVIDE(func_800448f8 = ABSOLUTE(0x800448f8));
PROVIDE(func_8004497c = ABSOLUTE(0x8004497c));
PROVIDE(func_800449b8 = ABSOLUTE(0x800449b8));
PROVIDE(func_800449fc = ABSOLUTE(0x800449fc));
PROVIDE(func_80044a0c = ABSOLUTE(0x80044a0c));
PROVIDE(func_80044A0C = ABSOLUTE(0x80044A0C));
PROVIDE(func_80044a7c = ABSOLUTE(0x80044a7c));
PROVIDE(func_80044b04 = ABSOLUTE(0x80044b04));
PROVIDE(func_80044b58 = ABSOLUTE(0x80044b58));
PROVIDE(func_80044b88 = ABSOLUTE(0x80044b88));
PROVIDE(func_80044c58 = ABSOLUTE(0x80044c58));
PROVIDE(func_80044c90 = ABSOLUTE(0x80044c90));
PROVIDE(func_80044cc4 = ABSOLUTE(0x80044cc4));
PROVIDE(func_80044d40 = ABSOLUTE(0x80044d40));
PROVIDE(func_80044dc8 = ABSOLUTE(0x80044dc8));
PROVIDE(func_80044e10 = ABSOLUTE(0x80044e10));
PROVIDE(func_80044e64 = ABSOLUTE(0x80044e64));
PROVIDE(func_80044f20 = ABSOLUTE(0x80044f20));
PROVIDE(func_80044f90 = ABSOLUTE(0x80044f90));
PROVIDE(func_8004500c = ABSOLUTE(0x8004500c));
PROVIDE(func_80045060 = ABSOLUTE(0x80045060));
PROVIDE(func_800450b4 = ABSOLUTE(0x800450b4));
PROVIDE(func_800451a8 = ABSOLUTE(0x800451a8));
PROVIDE(func_800451b8 = ABSOLUTE(0x800451b8));
PROVIDE(func_80045228 = ABSOLUTE(0x80045228));
PROVIDE(func_800452ac = ABSOLUTE(0x800452ac));
PROVIDE(func_800452fc = ABSOLUTE(0x800452fc));
PROVIDE(func_800453dc = ABSOLUTE(0x800453dc));
PROVIDE(func_80045428 = ABSOLUTE(0x80045428));
PROVIDE(func_800454c4 = ABSOLUTE(0x800454c4));
PROVIDE(func_800455d4 = ABSOLUTE(0x800455d4));
PROVIDE(func_8004564c = ABSOLUTE(0x8004564c));
PROVIDE(func_8004575c = ABSOLUTE(0x8004575c));
PROVIDE(func_800457c0 = ABSOLUTE(0x800457c0));
PROVIDE(func_800458ac = ABSOLUTE(0x800458ac));
PROVIDE(func_800458b8 = ABSOLUTE(0x800458b8));
PROVIDE(func_8004593c = ABSOLUTE(0x8004593c));
PROVIDE(func_80045948 = ABSOLUTE(0x80045948));
PROVIDE(func_80045a38 = ABSOLUTE(0x80045a38));
PROVIDE(func_80045ac8 = ABSOLUTE(0x80045ac8));
PROVIDE(func_80045ad0 = ABSOLUTE(0x80045ad0));
PROVIDE(func_80045ad8 = ABSOLUTE(0x80045ad8));
PROVIDE(func_80045bc0 = ABSOLUTE(0x80045bc0));
PROVIDE(func_80045bc8 = ABSOLUTE(0x80045bc8));
PROVIDE(func_80045c94 = ABSOLUTE(0x80045c94));
PROVIDE(func_80045cfc = ABSOLUTE(0x80045cfc));
PROVIDE(func_80045de0 = ABSOLUTE(0x80045de0));
PROVIDE(func_80045e18 = ABSOLUTE(0x80045e18));
PROVIDE(func_80045e3c = ABSOLUTE(0x80045e3c));
PROVIDE(func_80045e44 = ABSOLUTE(0x80045e44));
PROVIDE(func_80045e54 = ABSOLUTE(0x80045e54));
PROVIDE(func_80045e8c = ABSOLUTE(0x80045e8c));
PROVIDE(func_80045f18 = ABSOLUTE(0x80045f18));
PROVIDE(func_80045f78 = ABSOLUTE(0x80045f78));
PROVIDE(func_80045f84 = ABSOLUTE(0x80045f84));
PROVIDE(func_80046000 = ABSOLUTE(0x80046000));
PROVIDE(func_80046020 = ABSOLUTE(0x80046020));
PROVIDE(func_80046040 = ABSOLUTE(0x80046040));
PROVIDE(func_80046060 = ABSOLUTE(0x80046060));
PROVIDE(func_80046084 = ABSOLUTE(0x80046084));
PROVIDE(func_800460a8 = ABSOLUTE(0x800460a8));
PROVIDE(func_800461b0 = ABSOLUTE(0x800461b0));
PROVIDE(func_80046244 = ABSOLUTE(0x80046244));
PROVIDE(func_800462d4 = ABSOLUTE(0x800462d4));
PROVIDE(func_8004636c = ABSOLUTE(0x8004636c));
PROVIDE(func_80046404 = ABSOLUTE(0x80046404));
PROVIDE(func_80046538 = ABSOLUTE(0x80046538));
PROVIDE(func_80046568 = ABSOLUTE(0x80046568));
PROVIDE(func_800465b8 = ABSOLUTE(0x800465b8));
PROVIDE(func_800465e8 = ABSOLUTE(0x800465e8));
PROVIDE(func_8004691c = ABSOLUTE(0x8004691c));
PROVIDE(func_80046cf8 = ABSOLUTE(0x80046cf8));
PROVIDE(func_80046f0c = ABSOLUTE(0x80046f0c));
PROVIDE(func_80046f88 = ABSOLUTE(0x80046f88));
PROVIDE(func_80047074 = ABSOLUTE(0x80047074));
PROVIDE(func_800470c8 = ABSOLUTE(0x800470c8));
PROVIDE(func_80047114 = ABSOLUTE(0x80047114));
PROVIDE(func_80047240 = ABSOLUTE(0x80047240));
PROVIDE(func_8004728c = ABSOLUTE(0x8004728c));
PROVIDE(func_800472ec = ABSOLUTE(0x800472ec));
PROVIDE(func_80047388 = ABSOLUTE(0x80047388));
PROVIDE(func_800473e4 = ABSOLUTE(0x800473e4));
PROVIDE(func_800474c8 = ABSOLUTE(0x800474c8));
PROVIDE(func_80047574 = ABSOLUTE(0x80047574));
PROVIDE(func_800475c8 = ABSOLUTE(0x800475c8));
PROVIDE(func_800475d0 = ABSOLUTE(0x800475d0));
PROVIDE(func_800475d8 = ABSOLUTE(0x800475d8));
PROVIDE(func_80047638 = ABSOLUTE(0x80047638));
PROVIDE(func_80047694 = ABSOLUTE(0x80047694));
PROVIDE(func_800477b0 = ABSOLUTE(0x800477b0));
PROVIDE(func_80047810 = ABSOLUTE(0x80047810));
PROVIDE(func_80047870 = ABSOLUTE(0x80047870));
PROVIDE(func_80047890 = ABSOLUTE(0x80047890));
PROVIDE(func_800478b0 = ABSOLUTE(0x800478b0));
PROVIDE(func_800478d0 = ABSOLUTE(0x800478d0));
PROVIDE(func_800478f8 = ABSOLUTE(0x800478f8));
PROVIDE(func_80047900 = ABSOLUTE(0x80047900));
PROVIDE(func_80047910 = ABSOLUTE(0x80047910));
PROVIDE(func_80047970 = ABSOLUTE(0x80047970));
PROVIDE(func_800479c8 = ABSOLUTE(0x800479c8));
PROVIDE(func_80047a5c = ABSOLUTE(0x80047a5c));
PROVIDE(func_80047ae4 = ABSOLUTE(0x80047ae4));
PROVIDE(func_80047b24 = ABSOLUTE(0x80047b24));
PROVIDE(func_8004849c = ABSOLUTE(0x8004849c));
PROVIDE(func_800484d0 = ABSOLUTE(0x800484d0));
PROVIDE(func_8004865c = ABSOLUTE(0x8004865c));
PROVIDE(func_8004867c = ABSOLUTE(0x8004867c));
PROVIDE(func_800486ac = ABSOLUTE(0x800486ac));
PROVIDE(func_80048770 = ABSOLUTE(0x80048770));
PROVIDE(func_800487d8 = ABSOLUTE(0x800487d8));
PROVIDE(func_800488e4 = ABSOLUTE(0x800488e4));
PROVIDE(func_80048960 = ABSOLUTE(0x80048960));
PROVIDE(func_800489b4 = ABSOLUTE(0x800489b4));
PROVIDE(func_80048a68 = ABSOLUTE(0x80048a68));
PROVIDE(func_80048aac = ABSOLUTE(0x80048aac));
PROVIDE(func_80048b78 = ABSOLUTE(0x80048b78));
PROVIDE(func_80048bc0 = ABSOLUTE(0x80048bc0));
PROVIDE(func_80048c98 = ABSOLUTE(0x80048c98));
PROVIDE(func_80048cd8 = ABSOLUTE(0x80048cd8));
PROVIDE(func_80048ce0 = ABSOLUTE(0x80048ce0));
PROVIDE(func_80048cf0 = ABSOLUTE(0x80048cf0));
PROVIDE(func_80048cfc = ABSOLUTE(0x80048cfc));
PROVIDE(func_80048d28 = ABSOLUTE(0x80048d28));
PROVIDE(func_80048d64 = ABSOLUTE(0x80048d64));
PROVIDE(func_80048df8 = ABSOLUTE(0x80048df8));
PROVIDE(func_80048e2c = ABSOLUTE(0x80048e2c));
PROVIDE(func_80048e80 = ABSOLUTE(0x80048e80));
PROVIDE(func_80048f60 = ABSOLUTE(0x80048f60));
PROVIDE(func_8004903c = ABSOLUTE(0x8004903c));
PROVIDE(func_800490f4 = ABSOLUTE(0x800490f4));
PROVIDE(func_80049110 = ABSOLUTE(0x80049110));
PROVIDE(func_8004913c = ABSOLUTE(0x8004913c));
PROVIDE(func_800491cc = ABSOLUTE(0x800491cc));
PROVIDE(func_800491fc = ABSOLUTE(0x800491fc));
PROVIDE(func_80049240 = ABSOLUTE(0x80049240));
PROVIDE(func_80049270 = ABSOLUTE(0x80049270));
PROVIDE(func_800492d0 = ABSOLUTE(0x800492d0));
PROVIDE(func_80049334 = ABSOLUTE(0x80049334));
PROVIDE(func_800493c8 = ABSOLUTE(0x800493c8));
PROVIDE(func_800493e4 = ABSOLUTE(0x800493e4));
PROVIDE(func_80059310 = DreamSys__SetFlag70);
PROVIDE(func_8005931C = DreamSys__GetValue74);
PROVIDE(func_8005931c = DreamSys__GetValue74);
PROVIDE(func_80059360 = DreamSys__GetRemainingTimeSeconds);
PROVIDE(func_8005937C = DreamSys__SetOffset58);
PROVIDE(func_8005937c = DreamSys__SetOffset58);
PROVIDE(func_80059384 = DreamSys__SetOffset5C);
PROVIDE(func_8005938C = DreamSys__SetOffset64);
PROVIDE(func_8005938c = DreamSys__SetOffset64);
PROVIDE(func_80059394 = DreamSys__CheckTimerModulo);
PROVIDE(func_8005942C = CalcDreamPosition);
PROVIDE(func_8005942c = CalcDreamPosition);
PROVIDE(func_8005950C = ABSOLUTE(0x8005950C));
PROVIDE(func_80059814 = CameraShakeUpdate);
PROVIDE(func_800598E8 = CamEffectUpdate);
PROVIDE(func_800598e8 = CamEffectUpdate);
PROVIDE(func_80059A1C = CounterUpdate);
PROVIDE(func_80059D1C = DispatchSubObject);
PROVIDE(func_80059d1c = DispatchSubObject);
PROVIDE(func_80059E98 = ProcessDreamAction);
PROVIDE(func_80059e98 = ProcessDreamAction);
PROVIDE(func_8005A1F4 = InitCheckLogic);
PROVIDE(func_8005a1f4 = InitCheckLogic);
PROVIDE(func_8005A700 = TestTunnelLink);
PROVIDE(func_8005a700 = TestTunnelLink);
PROVIDE(func_8005A7A0 = TestTunnelExitLink);
PROVIDE(func_8005a7a0 = TestTunnelExitLink);
PROVIDE(func_8005A82C = TestInstantTeleport);
PROVIDE(func_8005a82c = TestInstantTeleport);
PROVIDE(func_8005A9CC = TestStaircaseNodes);
PROVIDE(func_8005a9cc = TestStaircaseNodes);
PROVIDE(func_8005AB2C = StairAnimState1);
PROVIDE(func_8005ab2c = StairAnimState1);
PROVIDE(func_8005AC24 = StairAnimState2);
PROVIDE(func_8005ac24 = StairAnimState2);
PROVIDE(func_8005AD68 = StairAnimState3);
PROVIDE(func_8005ad68 = StairAnimState3);
PROVIDE(func_8005AE40 = StairAnimState4);
PROVIDE(func_8005ae40 = StairAnimState4);
PROVIDE(func_8005AF64 = ABSOLUTE(0x8005AF64));
PROVIDE(func_8005B904 = BackupStructData);
PROVIDE(func_8005b904 = BackupStructData);
PROVIDE(func_8005B990 = RestoreStructData);
PROVIDE(func_8005b990 = RestoreStructData);
PROVIDE(func_8005BD3C = LocationMatcher);
PROVIDE(func_8005BE28 = StairLocationMatcher);
PROVIDE(func_8005BE90 = RandomSpawnSelector);
PROVIDE(func_8005C02C = ABSOLUTE(0x8005C02C));
PROVIDE(DreamSys__func_58968 = DreamSys__SetupFromManager);
PROVIDE(func_800590e0 = DreamSys__EmptyFunc);
PROVIDE(func_80059a48 = DreamSys__Empty2);
PROVIDE(func_80059a50 = DreamSys__Empty3);
PROVIDE(func_8005c714 = EntityClearSoundChannel);
PROVIDE(func_8005C714 = EntityClearSoundChannel);
PROVIDE(func_8005cdf8 = SoundAdvanceDataPointer);
PROVIDE(func_8005CDF8 = SoundAdvanceDataPointer);
PROVIDE(func_800270b8 = ABSOLUTE(0x800270b8));
PROVIDE(func_8001eacc = ABSOLUTE(0x8001eacc));

/* Entity3_vtable.c PascalCase aliases for 79528.data.s lowercase refs */
PROVIDE(func_8005d1ec = EntityDestroy);
PROVIDE(func_8005d278 = EntityProcessMoodState);
PROVIDE(func_8005d314 = EntityReceiveChild);
PROVIDE(func_8005d418 = EntityReleaseChild);
PROVIDE(func_8005d480 = EntityProcessFrame);
PROVIDE(func_8005d560 = EntityHandleMessage);
PROVIDE(func_8005d658 = EntityHandleCollision);
PROVIDE(func_8005d6d4 = EntityTickAnimation);
PROVIDE(func_8005d7fc = EntityCalcManhattanDist);
PROVIDE(func_8005d864 = EntityCalcMoveProgress);
PROVIDE(func_8005d9f4 = EntityActivateState);
PROVIDE(func_8005da3c = EntityDeactivateState);
PROVIDE(func_8005daac = EntitySetChildState);
PROVIDE(func_8005dafc = EntityInitSequence);
PROVIDE(func_8005db8c = EntityResetSequence);
PROVIDE(func_8005dbf0 = EntityCheckTriggerState);
PROVIDE(func_8005dd18 = EntityCheckLinkState);
PROVIDE(func_8005de18 = EntityUpdateDirection);
PROVIDE(func_8005dee0 = EntityCheckActivity);
PROVIDE(func_8005e0b0 = EntityHandleActivityTimeout);
PROVIDE(func_8005e160 = EntityBehavior_WanderMultiPhase);
PROVIDE(func_8005e3c4 = EntityBehavior_InitApproach);
PROVIDE(func_8005e480 = EntityBehavior_InitQuick);
PROVIDE(func_8005e4d0 = EntityBehavior_MidCycleAnim);
PROVIDE(func_8005e694 = EntityBehavior_PlayAnimSound);
PROVIDE(func_8005e6f0 = EntityBehavior_PeriodicBounce);
PROVIDE(func_8005e7a8 = EntityBehavior_InitSubStateB);
PROVIDE(func_8005e7f8 = EntityBehavior_ComplexStateMove);
PROVIDE(func_8005ea94 = EntityBehavior_ProximityChase);
PROVIDE(func_8005ebb4 = EntityBehavior_CountedState);
PROVIDE(func_8005ec98 = EntityBehavior_ThresholdJump);
PROVIDE(func_8005ed10 = EntityBehavior_FrameZeroCheck);
PROVIDE(func_8005ed30 = EntityBehavior_RandomMoveAnim);
PROVIDE(func_8005ef20 = EntityBehavior_PlayAnim);
PROVIDE(func_8005ef54 = EntityBehavior_SlowDecelPeriodic);
PROVIDE(func_8005eff4 = EntityBehavior_RandomTriggerPeriodic);
PROVIDE(func_8005f0d8 = EntityBehavior_PeriodicStateAdvance);
PROVIDE(func_8005f1a8 = EntityBehavior_AimAtTarget);
PROVIDE(func_8005f1d4 = EntityBehavior_MultiPhaseSound);
PROVIDE(func_8005f368 = EntityBehavior_PeriodicAnimFlow);
PROVIDE(func_8005f454 = EntityBehavior_ThreePhaseState);
PROVIDE(func_8005f544 = EntityBehavior_PeriodicJump);
PROVIDE(func_8005f608 = EntityBehavior_SlowPeriodicState);
PROVIDE(func_8005f6d4 = EntityBehavior_PlayAnimSimple);
PROVIDE(func_8005f708 = EntityBehavior_RandomSubstateInit);
PROVIDE(func_8005f800 = EntityBehavior_MultiModeAnim);
PROVIDE(func_8005f970 = EntityBehavior_ChasePeriodic);
PROVIDE(func_8005fa64 = EntityBehavior_SetVelocitySimple);
PROVIDE(func_8005fa94 = EntityBehavior_StateFlagAnim);
PROVIDE(func_8005fb6c = EntityBehavior_SwitchAnimOnTimer);
PROVIDE(func_8005fc58 = EntityBehavior_Oscillate);
PROVIDE(func_8005fdfc = EntityBehavior_ChaseTarget);
PROVIDE(func_8005fec8 = EntityBehavior_MoveConstant);
PROVIDE(func_8005fef8 = EntityBehavior_PeriodicAction);
PROVIDE(func_8005ff7c = EntityBehavior_RandomBranch);
PROVIDE(func_800602ac = EntityBehavior_FallbackState);
PROVIDE(func_800603c4 = EntityBehavior_ThresholdTrigger);
PROVIDE(func_800604dc = EntityBehavior_RandomAnimState);
PROVIDE(func_800605d0 = EntityBehavior_RandomAnimMove);
PROVIDE(func_800607f8 = EntityBehavior_Nop);
PROVIDE(func_8006090c = EntityBehavior_ChildInteraction);
PROVIDE(func_80060a4c = EntityBehavior_OscillateVelocity);
PROVIDE(func_80060b34 = EntityBehavior_FlagDrivenState);
PROVIDE(func_80060cf0 = EntityBehavior_StateOnMatch);
PROVIDE(func_80060d80 = EntityBehavior_TimedAnimSwitch);
PROVIDE(func_80060f38 = EntityBehavior_AnimPhaseState);
PROVIDE(func_80061a90 = EntityBehavior_RandomDirState);
PROVIDE(func_80061c04 = EntityBehavior_TriggerAt30);
PROVIDE(func_80061c2c = EntityBehavior_ProximityComplex);
PROVIDE(func_80061e60 = EntityBehavior_ModuloState);
PROVIDE(func_80061f30 = EntityBehavior_SubStateAnim);
PROVIDE(func_8006204c = EntityBehavior_PeriodicStateD);
PROVIDE(func_800620c4 = EntityBehavior_DelayedAnim);
PROVIDE(func_800621a8 = EntityBehavior_DirectionState);
PROVIDE(func_800623e8 = EntityBehavior_MultiPeriodState);
PROVIDE(func_800624bc = EntityBehavior_RandomMove);
PROVIDE(func_800628d4 = EntityBehavior_InitResetState);
PROVIDE(func_80062a40 = EntityBehavior_TimedAnimState);
PROVIDE(func_80062c58 = EntityBehavior_MultiPhaseMove);
PROVIDE(func_80062fac = EntityBehavior_PeriodicSubstate);
PROVIDE(func_800634a8 = EntityBehavior_RandomAnimPhase);
PROVIDE(func_800636e4 = EntityBehavior_PeriodicReset);
PROVIDE(func_80063bc0 = EntityBehavior_PhaseEnd);
PROVIDE(func_80063cc8 = EntityBehavior_WrapState);
PROVIDE(func_80063d40 = EntityBehavior_MidpointTrigger);
PROVIDE(func_80063dc8 = EntityBehavior_TriggerOnDelay);
PROVIDE(func_80063e68 = EntityBehavior_RandomBranchState);
PROVIDE(func_80063ed4 = EntityBehavior_ChildScan);
PROVIDE(func_800641c0 = EntityBehavior_PeriodicStateEnd);
PROVIDE(func_800644e8 = EntityBehavior_RandomRoll);
PROVIDE(func_800646d8 = EntityBehavior_ProgressiveAnim);
PROVIDE(func_80064aa4 = EntityBehavior_AnimDecel);
PROVIDE(func_80064b14 = EntityBehavior_RandomActivate);
PROVIDE(func_80064b80 = EntityBehavior_OscillateMove);
PROVIDE(func_80064ca4 = EntityBehavior_AnimWithOffset);
PROVIDE(func_80064cec = EntityBehavior_AnimAndMove);
PROVIDE(func_80064d48 = EntityBehavior_ProximitySubstate);
PROVIDE(func_80064e34 = EntityBehavior_MultiPhaseThreshold);
PROVIDE(func_800650d4 = EntityBehavior_Nop2);
PROVIDE(func_800650f4 = EntityBehavior_RandomAnimSelect);
PROVIDE(func_8006519c = EntityBehavior_PlayAnim238A);
PROVIDE(func_800651d0 = EntityBehavior_PlayAnim238B);
PROVIDE(func_8006536c = EntityBehavior_PeriodicAnimState);
PROVIDE(func_800654a0 = EntityBehavior_AimAndAnimate);



/* PROVIDE aliases for Rendering.c PascalCase functions (Phase 6 rename) */
PROVIDE(func_80020510 = Prim_SetDrawOffset);
PROVIDE(func_8002c12c = Cd_New);
PROVIDE(func_800398e0 = StageChunk_New);
PROVIDE(func_800398E0 = StageChunk_New);
PROVIDE(func_8003b39c = Texture_New);
PROVIDE(func_8003b624 = Prim_DrawTiles);
PROVIDE(func_8003B624 = Prim_DrawTiles);
PROVIDE(func_8003dfbc = NavMenu_GetDataPtr);
PROVIDE(func_8003e5c8 = Font_GetDataPtr);
PROVIDE(func_8003f24c = ChunkData_GetDataPtr);
PROVIDE(func_800404d0 = Particle_New);
PROVIDE(func_800408cc = TextInput_New);
PROVIDE(func_80040fc0 = Sjis_Decode);
PROVIDE(func_80041020 = Sjis_EncodeFromAscii);
PROVIDE(func_8004109c = Sjis_FormatNumber);
PROVIDE(func_80041ab4 = TextInput_NewLabel);
PROVIDE(func_80041c9c = TextInput_NewFont);
PROVIDE(func_80041C9C = TextInput_NewFont);
PROVIDE(func_800422bc = Font_GetVtableData);
PROVIDE(func_800422BC = Font_GetVtableData);
PROVIDE(func_80042400 = StageGrid_New);
PROVIDE(func_800428e4 = StageGrid_GetDataPtr);
PROVIDE(func_800428E4 = StageGrid_GetDataPtr);
PROVIDE(func_80043008 = TextInput_NewRenderer);
PROVIDE(func_80043840 = Tmd_New);
PROVIDE(func_8004468c = Spu_New);
PROVIDE(func_8004468C = Spu_New);
PROVIDE(func_80048894 = Snd_New);
PROVIDE(func_80048d48 = Snd_GetAmbientPath);
PROVIDE(func_80048D48 = Snd_GetAmbientPath);
PROVIDE(func_80048d74 = Snd_SelectAmbient);
PROVIDE(func_80048D74 = Snd_SelectAmbient);
PROVIDE(func_80048e08 = Snd_GetCurrentAmbient);
PROVIDE(func_80048E08 = Snd_GetCurrentAmbient);
PROVIDE(func_80048ea0 = Snd_RandomSelect);
PROVIDE(func_80048EA0 = Snd_RandomSelect);
PROVIDE(func_80048f84 = Snd_SelectSfx);
PROVIDE(func_80048F84 = Snd_SelectSfx);
PROVIDE(func_80049060 = Font_GetCharData);
PROVIDE(func_80049098 = Font_AdvanceCursor);
PROVIDE(func_800494d8 = Font_GetGridData);
PROVIDE(func_80049684 = Stage_Init);
PROVIDE(func_80049830 = Stage_Destroy);
PROVIDE(func_80049958 = Stage_HandleMessage);
PROVIDE(func_80049a14 = Stage_ResetState);
PROVIDE(func_80049a1c = Stage_Update);
PROVIDE(func_80049ac0 = Stage_Draw);
PROVIDE(func_80049b54 = Stage_SetupRender);
PROVIDE(func_80049c50 = Stage_Release);
PROVIDE(func_80049ca8 = Stage_HandleState);
PROVIDE(func_80049e20 = Stage_CreateToken);
PROVIDE(func_80049ea4 = Stage_Nop);
PROVIDE(func_80049eac = Stage_Nop2);
PROVIDE(func_80049eb4 = Stage_HandleTransition);
PROVIDE(func_8004a070 = Cd_SplitStreamRead);
PROVIDE(func_8004a130 = StageSub_Alloc);
PROVIDE(func_8004a19c = StageSub_Init);
PROVIDE(func_8004a228 = StageSub_Destroy);
PROVIDE(func_8004a294 = StageSub_Reset);
PROVIDE(func_8004a2c4 = StageSub_Process);
PROVIDE(func_8004a324 = StageSub_Run);
PROVIDE(func_8004a35c = StageSub_Nop);
PROVIDE(func_8004a364 = StageSub_CheckBuffer);
PROVIDE(func_8004a3ec = StageSub_HandleEvent);
PROVIDE(func_8004a458 = StageSub_SetMaxCount);
PROVIDE(func_8004a478 = StageSub_SetVolume);
PROVIDE(func_8004a4c8 = StageGrid_Alloc);
PROVIDE(func_8004a534 = StageGrid_Init);
PROVIDE(func_8004a7c0 = StageGrid_Destroy);
PROVIDE(func_8004a984 = StageGrid_DrawPrimitive);
PROVIDE(func_8004aa10 = StageGrid_ResetState);
PROVIDE(func_8004aa6c = StageGrid_HandleChannelEvent);
PROVIDE(func_8004ab24 = StageGrid_Submit);
PROVIDE(func_8004ab88 = StageGrid_CheckDrawMode);
PROVIDE(func_8004abd0 = StageGrid_ResetChannels);
PROVIDE(func_8004acf8 = StageGrid_SetupChunks);
PROVIDE(func_8004adc4 = StageSub_SetPosition);
PROVIDE(func_8004add0 = StageSub_SetFlag);
PROVIDE(func_8004add8 = StageSub_CheckIdList);
PROVIDE(func_8004aea4 = StageSub_Render);
PROVIDE(func_8004afe0 = Render_SetViewport);
PROVIDE(func_8004b030 = Render_CalcClipRect);
PROVIDE(func_8004b100 = Render_SubmitChunks);
PROVIDE(func_8004b2d4 = Chunk_RenderIfVisible);
PROVIDE(func_8004b31c = StageGrid_GetBufferEnd);
PROVIDE(func_8004b324 = StageGrid_Nop);
PROVIDE(func_8004b32c = StageSub_SetDepthShift);
PROVIDE(func_8004b344 = StageSub_SetMode);
PROVIDE(func_8004b38c = Render_UnpackPrimitive);
PROVIDE(func_8004b418 = Prim_CalcScreenPos);
PROVIDE(func_8004b44c = Prim_CalcScreenCoord);
PROVIDE(func_8004b570 = StageSub_SetActive);
PROVIDE(func_8004b57c = StageSub_ClearBuffer);
PROVIDE(func_8004b5bc = StageSub_RefreshState);
PROVIDE(func_8004b700 = StageGrid_RenderChannels);
PROVIDE(func_8004b930 = StageGrid_GetVisMask);
PROVIDE(func_8004ba40 = StageGrid_GetChunkEntry);
PROVIDE(func_8004bb3c = StageGrid_UpdateChannels);
PROVIDE(func_8004bce0 = StageGrid_CountActiveChannels);
PROVIDE(func_8004bd14 = StageGrid_ProcessChannelState);
PROVIDE(func_8004be54 = Tmd_LoadModel);
PROVIDE(func_8004c0ac = StageGrid_ResetPrimitives);
PROVIDE(func_8004c158 = StageGrid_GetRenderBuffer);
PROVIDE(func_8004c1c0 = StageGrid_WorldToTile);
PROVIDE(func_8004c368 = Prim_WriteModDiv);
PROVIDE(func_8004c3f0 = Chunk_CalcTileCoord);
PROVIDE(func_8004c434 = Chunk_FindByType);
PROVIDE(func_8004c470 = Chunk_FindByCoord);
PROVIDE(func_8004c588 = Chunk_FindIndexByType);
PROVIDE(func_8004c5d0 = Chunk_FindActiveIndex);
PROVIDE(func_8004c620 = Chunk_RenderDispatch);
PROVIDE(func_8004c6a8 = Chunk_UpdateRenderTransform);
PROVIDE(func_8004c93c = Chunk_BuildSliceEntries);
PROVIDE(func_8004caf0 = Chunk_BuildSliceOverflow);
PROVIDE(func_8004cc74 = Chunk_RenderGpu);
PROVIDE(func_8004cd38 = Prim_IsPointInRect);
PROVIDE(func_8004cda4 = Chunk_SetupRenderSlot);
PROVIDE(func_8004ce24 = Chunk_ProcessRenderList);
PROVIDE(func_8004cfa8 = Chunk_GetFadeArea);
PROVIDE(func_8004cfb0 = Chunk_SetFadeValue);
PROVIDE(func_8004cfb8 = Chunk_SetupFadeParams);
PROVIDE(func_8004d028 = Chunk_ApplyFadeTick);
PROVIDE(func_8004d088 = Chunk_ResetFade);
PROVIDE(func_8004d0d0 = ChunkData_ApplyFade);
PROVIDE(func_8004d108 = Chunk_RenderFadeScreen);
PROVIDE(func_8004d140 = Chunk_ApplyToAll);
PROVIDE(func_8004d1d0 = Chunk_ApplyToAllEntries);
PROVIDE(func_8004d244 = Stage_GetChunkVtable);
PROVIDE(func_8004d254 = ChunkData_Alloc);
PROVIDE(func_8004d2a4 = ChunkData_Constructor);
PROVIDE(func_8004d2f8 = ChunkData_Nop);
PROVIDE(func_8004d300 = ChunkData_Render);
PROVIDE(func_8004d35c = ChunkDataTable_Nop01);
PROVIDE(func_8004d364 = ChunkDataTable_Nop02);
PROVIDE(func_8004d36c = ChunkDataTable_Nop03);
PROVIDE(func_8004d374 = ChunkDataTable_Nop04);
PROVIDE(func_8004d37c = Stage_GetChunkDataVtable);
PROVIDE(func_8004d38c = ChunkDataTable_Alloc);
PROVIDE(func_8004d3dc = ChunkDataTable_Constructor);
PROVIDE(func_8004d42c = ChunkDataTable_Nop05);
PROVIDE(func_8004d434 = ChunkDataTable_CheckChar4);
PROVIDE(func_8004d47c = ChunkDataTable_ProcessInput);
PROVIDE(func_8004d500 = ChunkDataTable_Identity);
PROVIDE(func_8004d508 = Stage_GetChunkDataTableVtable);
PROVIDE(func_8004D518 = StageEntity_Alloc);
PROVIDE(func_8004d578 = StageEntity_Constructor);
PROVIDE(func_8004d678 = StageEntity_SetDreamFlag);
PROVIDE(func_8004d6ac = Stage_SetupChallengeData);
PROVIDE(func_8004d704 = NavMenu_CloseNav);
PROVIDE(func_8004d788 = NavMenu_HandleMessage);
PROVIDE(func_8004d814 = NavMenu_InitTitle);
PROVIDE(func_8004d898 = NavMenu_DrawAc);
PROVIDE(func_8004d90c = NavMenu_HandleState);
PROVIDE(func_8004d9d4 = NavMenu_Update);
PROVIDE(func_8004dabc = NavMenu_UpdateColour);
PROVIDE(func_8004db18 = NavMenu_CreateSaveText);
PROVIDE(func_8004dc08 = NavMenu_DestroyNav);
PROVIDE(func_8004dc64 = NavMenu_Poll);
PROVIDE(func_8004dcd0 = NavMenu_DrawChar);
PROVIDE(func_8004de08 = NavMenu_CommitSave);
PROVIDE(func_8004df64 = NavMenu_DrawFileList);
PROVIDE(func_8004e054 = NavMenu_CloseFileList);
PROVIDE(func_8004e0e4 = NavMenu_SaveFile);
PROVIDE(func_8004e1c4 = NavMenu_LoadFile);
PROVIDE(func_8004e230 = NavMenu_HandleInput);
PROVIDE(func_8004e2d0 = MemoryCard_GetVtable);
PROVIDE(func_8004e2e0 = MemoryCard_New);
PROVIDE(func_8004e34c = MemoryCard_Constructor);
PROVIDE(func_8004e3f4 = MemoryCard_ClearFields);
PROVIDE(func_8004e40c = MemoryCard_Destructor);
PROVIDE(func_8004e444 = MemoryCard_SetBuffer);
PROVIDE(func_8004e4e8 = MemoryCard_ClearBuffer);
PROVIDE(func_8004e588 = MemoryCard_ResetBuffers);
PROVIDE(func_8004e5d4 = MemoryCard_SetFileNo);
PROVIDE(func_8004e5e4 = MemoryCard_OpenEvents);
PROVIDE(func_8004e678 = MemoryCard_CloseEvents);
PROVIDE(func_8004e6b8 = MemoryCard_ReadFile);
PROVIDE(func_8004e77c = MemoryCard_DetectAndLoad);
PROVIDE(func_8004e7d0 = MemoryCard_DetectCard);
PROVIDE(func_8004e890 = MemoryCard_LoadCardData);
PROVIDE(func_8004e940 = MemoryCard_Format);
PROVIDE(func_8004e9ac = MemoryCard_ReadFileRetry);
PROVIDE(func_8004ea38 = MemoryCard_ReadFileTitle);
PROVIDE(func_8004eadc = MemoryCard_FindFileEntry);
PROVIDE(func_8004eb88 = MemoryCard_FindFiles);
PROVIDE(func_8004ec5c = MemoryCard_DeleteFileRetry);
PROVIDE(func_8004eccc = MemoryCard_DeleteFile);
PROVIDE(func_8004ed40 = MemoryCard_ReadDataRetry);
PROVIDE(func_8004edc0 = MemoryCard_ReadDataFile);
PROVIDE(func_8004eea0 = MemoryCard_WriteDataRetry);
PROVIDE(func_8004ef6c = MemoryCard_WriteFileSaveData);
PROVIDE(func_8004f32c = MemoryCard_BuildPath);
PROVIDE(func_8004f394 = MemoryCard_EnableEvents);
PROVIDE(func_8004f3bc = MemoryCard_DisableEvents);
PROVIDE(func_8004f3e4 = MemoryCard_TestEvents);
PROVIDE(func_8004f40c = MemoryCard_CallEventFunc);
PROVIDE(func_8004f4a4 = MemoryCard_PollCardStatus);
PROVIDE(func_8004f4c8 = MemoryCard_PollEvents);
PROVIDE(func_8004f55c = NavMenu_StateNoCard);
PROVIDE(func_8004f5dc = NavMenu_StateCardInit);
PROVIDE(func_8004f638 = NavMenu_StateCardFormat);
PROVIDE(func_8004f704 = MemoryCard_AllocBuffers);
PROVIDE(func_8004f784 = MemoryCard_FreeBuffers);
PROVIDE(func_8004f810 = MemoryCard_FreeAllBuffers);
PROVIDE(func_8004f8a4 = NavMenu_StateCardFileMenu);
PROVIDE(func_8004f9d8 = NavMenu_CardCheckState);
PROVIDE(func_8004fb04 = NavMenu_StateCardSave);
PROVIDE(func_8004fbe4 = NavMenu_StateCardLoad);
PROVIDE(func_8004fe24 = NavMenu_StateCardDelete);
PROVIDE(func_8004ff40 = NavMenu_StateCardError);
PROVIDE(func_8004ff90 = NavMenu_StateCardBusy);
PROVIDE(func_8004fff4 = NavMenu_StateCardPoll);
PROVIDE(func_80050034 = NavMenu_StateTransition);
PROVIDE(func_800501f0 = TextInput_Constructor);
PROVIDE(func_80050280 = NavMenu_WaitTimer);
PROVIDE(func_80050340 = NavMenu_DrawText);
PROVIDE(func_80050410 = NavMenu_DestroyText);
PROVIDE(func_800504d0 = TextInput_Destructor);
PROVIDE(func_800505a8 = TextInput_Update);
PROVIDE(func_80050670 = TextInput_DestroySubBuffer);
PROVIDE(func_80050730 = TextInput_SetState);
PROVIDE(func_800507e8 = MemoryCard_GetVtable);
PROVIDE(func_800507f8 = Gpu_SetupCardPrimitive);
PROVIDE(func_80050ba8 = TextInput_CreateBuffer);
PROVIDE(func_80050c14 = TextInput_DrawText);
PROVIDE(func_80050cd8 = TextInput_ResetRenderState);
PROVIDE(func_80050ce8 = TextInput_GetLineCount);
PROVIDE(func_80050d30 = TextInput_GetCharPos);
PROVIDE(func_80050db4 = TextInput_CountChars);
PROVIDE(func_80050e34 = TextInput_EraseChar);
PROVIDE(func_80050e78 = TextInput_InsertChar);
PROVIDE(func_80050f28 = TextInput_ScrollLine);
PROVIDE(func_80050f98 = TextInput_GetStringWidth);
PROVIDE(func_80051174 = TextInput_CleanupChain);
PROVIDE(func_80051200 = TextInput_InitState);
PROVIDE(func_80051270 = TextInput_ReleaseObjects);
PROVIDE(func_800512c8 = TextInput_GetCursorPos);
PROVIDE(func_80051370 = TextInput_AutoSelectTimer);
PROVIDE(func_800513d0 = TextInput_MakeChoice);
PROVIDE(func_8005161c = TextInput_RenderChar);
PROVIDE(func_8005165c = TextInput_UpdateCursor);
PROVIDE(func_800516c0 = TextInput_CheckLimit);
PROVIDE(func_80051720 = TextInput_ScrollDown);
PROVIDE(func_80051784 = TextInput_ScrollUp);
PROVIDE(func_800517ec = TextInput_ProcessEvents);
PROVIDE(func_80051814 = TextInput_ScrollHome);
PROVIDE(func_80051858 = TextInput_RefreshList);
PROVIDE(func_800518f4 = TextInput_StartBlink);
PROVIDE(func_80051998 = TextInput_WriteChar);
PROVIDE(func_80051a4c = Entity2_GetVtable);
PROVIDE(func_80051a5c = TextInput_CreateObject);
PROVIDE(func_80051ac8 = TextInput_CreateFromList);
PROVIDE(func_80051c74 = TextInput_ResetState);
PROVIDE(func_80051c84 = TextInput_DestroyList);
PROVIDE(func_80051d1c = TextInput_AttachItem);
PROVIDE(func_80051da0 = TextInput_DetachItem);
PROVIDE(func_80051e20 = TextInput_ClearItems);
PROVIDE(func_80051e64 = TextInput_SetItem);
PROVIDE(func_80051f14 = TextInput_ClearCoords);
PROVIDE(func_80051f24 = TextInput_LoadMc);
PROVIDE(func_800520a0 = TextInput_UnloadMc);
PROVIDE(func_80052110 = TextInput_BeginInput);
PROVIDE(func_8005217c = TextInput_EndInput);
PROVIDE(func_800521d4 = TextInput_SetMode);
PROVIDE(func_8005227c = TextInput_GetText);
PROVIDE(func_800522dc = TextInput_SetText);
PROVIDE(func_800523f0 = TextInput_SetFlag);
PROVIDE(func_80052430 = TextInput_ClearFlag);
PROVIDE(func_80052498 = TextInput_MoveUp);
PROVIDE(func_800524f8 = TextInput_MoveDown);
PROVIDE(func_80052598 = TextInput_MovePage);
PROVIDE(func_80052644 = TextInput_ClipText);
PROVIDE(func_8005278c = TextInput_RedrawItem);
PROVIDE(func_8005281c = TextInput_SetRect);
PROVIDE(func_8005292c = TextInput_FormatLine);
PROVIDE(func_800529fc = TextInput_DrawToken);
PROVIDE(func_80052a58 = TextInput_RefreshToken);
PROVIDE(func_80052b54 = TextInput_GetTokenState);
PROVIDE(func_80052b60 = GetTextInputVtable);
PROVIDE(func_80052b70 = TextInput_CreateToken);
PROVIDE(func_80052c10 = TextInput_DrawLine);
PROVIDE(func_80052cd8 = TextInput_FreeToken);
PROVIDE(func_80052d10 = TextInput_DrawTokenList);
PROVIDE(func_80052de0 = TextInput_PollToken);
PROVIDE(func_80052de8 = TextInput_SetTokenPos);
PROVIDE(func_80052e7c = Font_ProcessChar);
PROVIDE(func_80052ebc = TextInput_InitRenderer);
PROVIDE(func_80052f10 = TextInput_RenderCharAt);
PROVIDE(func_80053134 = TextInput_DrawCursor);
PROVIDE(func_800531a0 = TextInput_GetRenderWidth);
PROVIDE(func_800531cc = TextInput_InitFont);
PROVIDE(func_80053358 = TextInput_EndFont);
PROVIDE(func_800533f0 = TextInput_CycleColour);
PROVIDE(func_80053458 = TextInput_GetColour);
PROVIDE(func_800534c0 = GetFontVtable);
PROVIDE(func_800534c8 = Font_Constructor);
PROVIDE(func_800536b0 = Font_Destructor);
PROVIDE(func_80053764 = Font_CharToGraphic);
PROVIDE(func_8005393c = Font_GetCharVram);
PROVIDE(func_80053984 = Font_DrawChar);
PROVIDE(func_80053acc = Font_DrawString);
PROVIDE(func_80053be8 = Font_GetStringWidth);
PROVIDE(func_80053c94 = Font_GetHeight);
PROVIDE(func_80053d18 = Font_GetCharWidth);
PROVIDE(func_80053d9c = Font_GetSpaceWidth);
PROVIDE(func_80053e00 = Font_GetTabWidth);
PROVIDE(func_80053e84 = Font_FlushVram);
PROVIDE(func_80053eb4 = Font_DrawVram);
PROVIDE(func_80053f84 = Font_CreateGraphic);
PROVIDE(func_800540e8 = Font_DeleteGraphic);
PROVIDE(func_80054120 = Font_IsLoaded);
PROVIDE(func_800541cc = GetStageEntityVtable);
PROVIDE(func_800541d4 = StageEntity_SetCollide);
PROVIDE(func_80054200 = StageEntity_WarpTo);
PROVIDE(func_80054208 = StageEntity_SetRender);
PROVIDE(func_8005426c = StageEntity_Delete);
PROVIDE(func_800542d0 = StageEntity_SetAlpha);
PROVIDE(func_800543fc = StageEntity_ApplyAlpha);
PROVIDE(func_800544d4 = GetVramTextureVtable);
PROVIDE(func_800544e4 = VramTexture_DrawFunc);
PROVIDE(func_80054558 = VramTexture_SetupDraw);
PROVIDE(func_800545fc = VramTexture_DecodeProps);
PROVIDE(func_80054660 = VramParticle_Spawn);
PROVIDE(func_80054714 = VramParticle_Destroy);
PROVIDE(func_80054758 = GetVramTexture2Vtable);
PROVIDE(func_80054850 = VramParticle_SpawnRing);
PROVIDE(func_800549a8 = VramParticle_UpdateAnim);
PROVIDE(func_80054b1c = Vector_AddWeighted);
PROVIDE(func_80054b50 = VramParticle_FreeArray);
PROVIDE(func_80054b84 = VramParticle_SpawnByType);
PROVIDE(func_80054c74 = VramParticle_DrawAll);
PROVIDE(func_80054cfc = VramParticle_FreeInstances);
PROVIDE(func_80054d30 = VramParticle_Cleanup);
PROVIDE(func_80054da4 = VramParticle_CreateType0);
PROVIDE(func_80054f30 = VramParticle_CreateType1);
PROVIDE(func_80054fd8 = VramParticle_CreateType2);
PROVIDE(func_8005511c = VramParticle_CreateType3);
PROVIDE(func_80055258 = RenderUtils_CallDraw);
PROVIDE(func_80055410 = RenderUtils_ApplyPpu);
PROVIDE(func_8005556c = RenderUtils_InitSubEntity);
PROVIDE(func_80055620 = RenderUtils_CreateSub);
PROVIDE(func_800557dc = RenderUtils_ClipSub);
PROVIDE(func_8005582c = RenderUtils_CheckSeed);
PROVIDE(func_80055874 = RenderUtils_GetSub);
PROVIDE(func_800558f0 = RenderUtils_CreateDisplay);
PROVIDE(func_80055a24 = StageGrid_DrawTiles);
PROVIDE(func_80055a88 = AnimTick_Type0);
PROVIDE(func_80055b10 = AnimTick_Type1);
PROVIDE(func_80055b6c = AnimTick_Type2);
PROVIDE(func_80055bc8 = AnimTick_Type3);
PROVIDE(func_80055ca8 = AnimTick_Type4);
PROVIDE(func_80055db4 = AnimTick_Type5);
PROVIDE(func_80055e94 = AnimTick_Type6);
PROVIDE(func_80055ef0 = AnimTick_Type7);
PROVIDE(func_80055f74 = AnimTick_Type8);
PROVIDE(func_80055fe8 = AnimTick_Type9);
PROVIDE(func_80056054 = RenderUtils_CallDisplay);
PROVIDE(func_800560e4 = AnimTick_Type11);
PROVIDE(func_80056194 = AnimTick_Type12);
PROVIDE(func_80056238 = AnimTick_Type13);
PROVIDE(func_8005627c = ComputeAnimDiv);
PROVIDE(func_8005630c = ParticleIsModeOff);
PROVIDE(func_80056320 = ParticleAllocate);
PROVIDE(func_800563c0 = ParticleConstruct);
PROVIDE(func_80056464 = ParticleDestruct);
PROVIDE(func_800564a4 = ParticleCopyParams);
PROVIDE(func_800564f4 = ParticleTickUpdate);
PROVIDE(func_80056520 = ParticleLinkToStage);
PROVIDE(func_80056640 = ParticleUpdatePosition);
PROVIDE(func_80056718 = ParticleSubtypeCleanup);
PROVIDE(func_80056794 = VectorAdd3);
PROVIDE(func_800567d4 = ParticleLinkSubObjects);
PROVIDE(func_80056858 = SubType0Render);
PROVIDE(func_800569a8 = SubType0AnimUpdate);
PROVIDE(func_80056b8c = SubType0Cleanup);
PROVIDE(func_80056bbc = SubType2Render);
PROVIDE(func_80056d18 = SubType2SpawnParticles);
PROVIDE(func_80056df0 = SubType2AnimUpdateStub);
PROVIDE(func_80056df8 = SubType0FreeChildren);
PROVIDE(func_80056e1c = SubType2Init);
PROVIDE(func_80056e44 = SubType3AnimUpdate);
PROVIDE(func_80056f28 = SubType3Cleanup);
PROVIDE(func_80056f4c = GetRenderStateVtable);
PROVIDE(func_80056f5c = ParticleSysInit);
PROVIDE(func_80056fe4 = ParticlePrimitiveAlloc);
PROVIDE(func_80057044 = PrimitiveConstruct);
PROVIDE(func_800570b4 = PrimitiveBind);
PROVIDE(func_80057130 = PrimitiveUnbind);
PROVIDE(func_800571a8 = PrimitiveDestruct);
PROVIDE(func_800571e8 = PrimitiveInitDefaults);
PROVIDE(func_800571f8 = PrimitiveDraw);
PROVIDE(func_80057320 = PrimitiveExecCommand);
PROVIDE(func_80057384 = ParticleStateSetRelative);
PROVIDE(func_800573a8 = ParticleStateSetAbsolute);
PROVIDE(func_800573cc = ParticleStateSetCore);
PROVIDE(func_80057444 = ParticleApplyTransform);
PROVIDE(func_8005748c = ParticleSetColour);
PROVIDE(func_800574c4 = VramPutImageClut);
PROVIDE(func_800574fc = VramPutImagePartSys6);
PROVIDE(func_80057534 = VramPutImageCore);
PROVIDE(func_800575b0 = RenderUtils_LoadImage);
PROVIDE(func_800575e0 = RenderUtils_StoreImage);
PROVIDE(func_80057610 = VtableStub_Nop);
PROVIDE(func_80057618 = RenderUtils_LoadStoreImage);
PROVIDE(func_80057668 = RenderUtils_GetDisplay);
PROVIDE(func_80057784 = RenderUtils_CalcDisplayParams);
PROVIDE(func_80057954 = RenderUtils_ProcessPrimitives);
PROVIDE(func_80057a18 = RenderUtils_FindVisibleNode);
PROVIDE(func_80057b54 = Node_CheckVisible);
PROVIDE(func_80057b90 = RenderUtils_DrawPrimitiveList);
PROVIDE(func_80057c14 = RenderUtils_DrawPrimitive);
PROVIDE(func_80057c6c = RenderUtils_SetParam48);
PROVIDE(func_80057c74 = VtableStub_Nop);
PROVIDE(func_80057c7c = RenderUtils_SetParam54);
PROVIDE(func_80057c84 = GetGameManagerAlias);
PROVIDE(func_80057c94 = NewNng);
PROVIDE(func_80057d10 = FontNng_Init);
PROVIDE(func_80057dbc = RenderUtils_SetAnimTable);
PROVIDE(func_80057df4 = CalcFixedPointDivide);
PROVIDE(func_80057f38 = VtableStub_Nop);
PROVIDE(func_80057f40 = VtableStub_Nop);
PROVIDE(func_80057f48 = VtableStub_Nop);
PROVIDE(func_80057f50 = VtableStub_Nop);
PROVIDE(func_80057f58 = GetNngVtable);
PROVIDE(func_80057F68 = NewStageArea);
PROVIDE(func_80057fc8 = StageArea_Init);
PROVIDE(func_80058078 = StageArea_InitHGraph);
PROVIDE(func_800580e0 = StageArea_Draw);
PROVIDE(func_800581c4 = StageArea_Update);
PROVIDE(func_80058228 = ParticleSys_Create);
PROVIDE(func_80058308 = ParticleSys_Destroy);
PROVIDE(func_80058390 = StageArea_GetState);
PROVIDE(func_80058404 = StageArea_SetupParticles);
PROVIDE(func_800585b4 = StageArea_NumToPos);
PROVIDE(func_80058694 = StageArea_UpdateParticles);
PROVIDE(func_80058764 = GetStageAreaVtable);
PROVIDE(func_8005c508 = SpuCinema_Init);
PROVIDE(func_8005c5e8 = SpuCinema_Free);
PROVIDE(func_8005c650 = Cinema_SetState);
PROVIDE(func_8005c76c = Cinema_FreeEntity);
PROVIDE(func_8005c7d4 = Cinema_TriggerSfx);
PROVIDE(func_8006573c = Entity_Setup);
PROVIDE(func_80065790 = Entity_UpdateCond);
PROVIDE(func_80065830 = Entity_Init);
PROVIDE(func_80065918 = Entity_SetupSub);
PROVIDE(func_800659d0 = Entity_CleanupSub);
PROVIDE(func_80065a5c = Entity_ForEachChild);
PROVIDE(func_80065ae0 = Entity_NotifyChildren);
PROVIDE(func_80065b80 = Entity_HandleEvent);
PROVIDE(func_80065bf4 = Entity_SetSoundFlag);
PROVIDE(func_80065bfc = Entity_SoundInitCheck);
PROVIDE(func_80065c2c = Entity_SoundDestroyCheck);
PROVIDE(func_80065c5c = Entity_SoundInit);
PROVIDE(func_80065cec = Entity_SoundDestroy);
PROVIDE(func_80065d64 = Entity_FindChild);
PROVIDE(func_80065dbc = Entity_ParticleInitCheck);
PROVIDE(func_80065dec = Entity_ParticleDestroyCheck);
PROVIDE(func_80065e1c = Entity_ParticleInit);
PROVIDE(func_80065f2c = Entity_ParticleDestroy);
PROVIDE(func_80065fd8 = Entity_TickAnim);
PROVIDE(func_800660bc = Entity_SetAnimCallback);
PROVIDE(func_8006613c = Entity_Show);
PROVIDE(func_80066148 = Entity_Hide);
PROVIDE(func_80066150 = Entity_UpdateVisible);
PROVIDE(func_800661c4 = Entity_Nop);
PROVIDE(func_800661cc = Entity_Nop2);
PROVIDE(func_800661d4 = Entity_SendToParent);
PROVIDE(func_80066214 = Entity_SelectAnim);
PROVIDE(func_800662a8 = Entity_EnableSpawn);
PROVIDE(func_800662b4 = Entity_DisableSpawn);
PROVIDE(func_800662bc = Entity_ParseCmdList);
PROVIDE(func_80066340 = Entity_ProcessAnimCmds);
PROVIDE(func_80066748 = Entity_LinkToParent);
PROVIDE(func_800667b0 = Entity_UnlinkParent);
PROVIDE(func_80066818 = GetDebugInputVtable);

/* PROVIDE aliases for 2C054.c PascalCase functions */
PROVIDE(func_8003b39c = Texture_New);
PROVIDE(func_8003B39C = Texture_New);
PROVIDE(func_8003b854 = Spu_NewSeqTrack);
PROVIDE(func_8003b8e4 = Spu_InitSeqTrack);
PROVIDE(func_8003b9dc = Spu_DelSeqTrack);
PROVIDE(func_8003ba38 = Spu_ResetSeqTrack);
PROVIDE(func_8003ba58 = Spu_SetSeqTrackPosition);
PROVIDE(func_8003bab4 = Spu_UpdateSeqTrack);
PROVIDE(func_8003bb5c = Spu_CheckSeqTrack);
PROVIDE(func_8003bc14 = Spu_SetSeqTrackState);
PROVIDE(func_8003bcf4 = Spu_SetSeqTrackPitchMod);
PROVIDE(func_8003bd10 = Spu_StopSeqTrack);
PROVIDE(func_8003bd74 = Spu_MuteSeqTrack);
PROVIDE(func_8003bdac = Spu_UnmuteSeqTrack);
PROVIDE(func_8003bde4 = Spu_Nop);
PROVIDE(func_8003bdec = Spu_Nop2);
PROVIDE(func_8003bdf4 = Spu_BranchSeqTrack);
PROVIDE(func_8003be5c = Spu_SetSeqTrackPitch);
PROVIDE(func_8003be64 = Spu_SetSeqTrackADSR);
PROVIDE(func_8003be6c = Spu_SetSeqTrackPan);
PROVIDE(func_8003be74 = Spu_SetSeqTrackVolume);
PROVIDE(func_8003be7c = Spu_SetSeqTrackReverb);
PROVIDE(func_8003be84 = Spu_GetSeqTrackVtable);
PROVIDE(func_8003be94 = NavMenu_NewPage);
PROVIDE(func_8003bf10 = NavMenu_InitPage);
PROVIDE(func_8003c008 = NavMenu_DelPage);
PROVIDE(func_8003c11c = NavMenu_InitContent);
PROVIDE(func_8003c1dc = NavMenu_GetField);
PROVIDE(func_8003c238 = NavMenu_Render);
PROVIDE(func_8003c3d0 = NavMenu_Update);
PROVIDE(func_8003c48c = NavMenu_HandleState);
PROVIDE(func_8003c51c = NavMenu_UpdateItem);
PROVIDE(func_8003c63c = NavMenu_SetItemState);
PROVIDE(func_8003c794 = NavMenu_SetItemSpacing);
PROVIDE(func_8003c7b4 = NavMenu_SetItemColor);
PROVIDE(func_8003c7f4 = NavMenu_Resume);
PROVIDE(func_8003c858 = NavMenu_Confirm);
PROVIDE(func_8003c8d0 = NavMenu_CancelAction);
PROVIDE(func_8003c944 = NavMenu_Next);
PROVIDE(func_8003c9b0 = NavMenu_Prev);
PROVIDE(func_8003ca1c = NavMenu_ChangePage);
PROVIDE(func_8003ca94 = NavMenu_Callback);
PROVIDE(func_8003caec = NavMenu_SetBounds);
PROVIDE(func_8003caf8 = NavMenu_SetOption);
PROVIDE(func_8003cb30 = NavMenu_SetOption2);
PROVIDE(func_8003cb68 = NavMenu_SetColor);
PROVIDE(func_8003cbb8 = NavMenu_SetField);
PROVIDE(func_8003cbc0 = NavMenu_Check);
PROVIDE(func_8003cc2c = NavMenu_Notify);
PROVIDE(func_8003ccdc = NavMenu_Advance);
PROVIDE(func_8003cd48 = NavMenu_FadeCheck);
PROVIDE(func_8003cde0 = NavMenu_LoadTexture);
PROVIDE(func_8003ce98 = NavMenu_Init);
PROVIDE(func_8003d050 = NavMenu_Destroy);
PROVIDE(func_8003d194 = NavMenu_Draw);
PROVIDE(func_8003d2cc = NavMenu_SetPosition);
PROVIDE(func_8003d3b0 = NavMenu_SelectNext);
PROVIDE(func_8003d444 = NavMenu_SelectPrev);
PROVIDE(func_8003d4dc = NavMenu_SetSelection);
PROVIDE(func_8003d5c0 = NavMenu_GetSelection);
PROVIDE(func_8003d5cc = NavMenu_AddItems);
PROVIDE(func_8003d6d4 = NavMenu_FreeItems);
PROVIDE(func_8003d73c = NavMenu_DrawItems);
PROVIDE(func_8003d980 = NavMenu_SetAllPositions);
PROVIDE(func_8003da10 = NavMenu_SelectState);
PROVIDE(func_8003dad4 = NavMenu_ConfirmState);
PROVIDE(func_8003dcac = NavMenu_CancelState);
PROVIDE(func_8003ddc8 = NavMenu_PageNext);
PROVIDE(func_8003de30 = NavMenu_PagePrev);
PROVIDE(func_8003de9c = NavMenu_NavigateToItem);
PROVIDE(func_8003dfa0 = NavMenu_GetEntryData);
PROVIDE(func_8003dfbc = NavMenu_GetDataPtr);
PROVIDE(func_8003dfcc = TypeEntry1_GetDataPtr);
PROVIDE(func_8003dfdc = Font_Construct);
PROVIDE(func_8003e030 = Font_Dispatch);
PROVIDE(func_8003e100 = Font_ResetState);
PROVIDE(func_8003e10c = Font_Init);
PROVIDE(func_8003e280 = Font_Destroy);
PROVIDE(func_8003e418 = Font_EventProc);
PROVIDE(func_8003e4a4 = Font_Tick);
PROVIDE(func_8003e4b8 = Font_SetMode);
PROVIDE(func_8003e538 = Font_Stop);
PROVIDE(func_8003e578 = Font_Start);
PROVIDE(func_8003e5c8 = Font_GetDataPtr);
PROVIDE(func_8003e5d8 = ChunkData_New);
PROVIDE(func_8003e628 = ChunkDataObj_Construct);
PROVIDE(func_8003e6cc = ChunkDataObj_Destroy);
PROVIDE(func_8003e770 = ChunkDataObj_SetChild);
PROVIDE(func_8003e7f4 = ChunkDataObj_RemoveChild);
PROVIDE(func_8003e874 = ChunkDataObj_Reset);
PROVIDE(func_8003e8b8 = ChunkDataObj_Dispatch);
PROVIDE(func_8003e968 = SpuVoice_InitDefaults);
PROVIDE(func_8003ea0c = SpuVoice_SetDimensions);
PROVIDE(func_8003ea24 = SpuVoice_SetDepth);
PROVIDE(func_8003ea2c = SpuVoice_SetUnk44);
PROVIDE(func_8003ea48 = SpuVoice_SetUnk48);
PROVIDE(func_8003ea64 = SpuVoice_SetUnk40);
PROVIDE(func_8003ea6c = SpuVoice_Nop1);
PROVIDE(func_8003ea74 = SpuVoice_Nop2);
PROVIDE(func_8003ea7c = SpuVoice_SetUnk54);
PROVIDE(func_8003ea84 = SpuVoice_SetColor);
PROVIDE(func_8003eaa4 = SpuVoice_SetColor2);
PROVIDE(func_8003eac4 = RenderView_SetViewport);
PROVIDE(func_8003eacc = RenderView_InitProjection);
PROVIDE(func_8003eb84 = RenderView_Deactivate);
PROVIDE(func_8003ebc4 = RenderView_SetRotation);
PROVIDE(func_8003ebf8 = RenderView_SetTranslation);
PROVIDE(func_8003ec2c = RenderView_SetScale);
PROVIDE(func_8003ecc0 = RenderView_StubNop);
PROVIDE(func_8003ecc8 = RenderView_StubNop2);
PROVIDE(func_8003ecd0 = RenderView_InitOt);
PROVIDE(func_8003edf4 = RenderView_FreeOt);
PROVIDE(func_8003ee40 = RenderView_AdvanceFrame);
PROVIDE(func_8003ee88 = RenderView_HandleMode);
PROVIDE(func_8003eec0 = RenderView_RenderScene);
PROVIDE(func_8003f04c = RenderView_FlipBuffers);
PROVIDE(func_8003f1a8 = RenderView_SetBackground);
PROVIDE(func_8003f230 = RenderView_GetBackground);
PROVIDE(func_8003f23c = RenderView_SetDrawMode);
PROVIDE(func_8003f244 = RenderView_SetFlags);
PROVIDE(func_8003f24c = ChunkData_GetDataPtr);
PROVIDE(func_8003f25c = RenderView_GetTailNode);
PROVIDE(func_8003f28c = RenderView_SetGeomScreen);
PROVIDE(func_8003fb0c = RenderView_SetClipNear);
PROVIDE(func_8003fbe4 = RenderView_SetClipFar);
PROVIDE(func_8003fe2c = Entity_ConstructFromTemplate);
PROVIDE(func_8003fed8 = Entity_InitState);
PROVIDE(func_8003ff44 = Entity_ProcessState);
PROVIDE(func_8004001c = Entity_SetFrame);
PROVIDE(func_80040024 = Entity_StateEnter);
PROVIDE(func_800400b0 = Entity_StateExit);
PROVIDE(func_80040154 = Entity_SetupAnimation);
PROVIDE(func_800402f0 = Entity_StateUpdate);
PROVIDE(func_800403f8 = Palette_GetTable);
PROVIDE(func_8004042c = Palette_SaveAndSet);
PROVIDE(func_80040490 = Palette_Restore);
PROVIDE(func_800404b4 = Palette_SetParams);
PROVIDE(func_800404c0 = Palette_GetBaseTable);
PROVIDE(func_800404d0 = Particle_New);
PROVIDE(func_8004054c = Primitive_Construct);
PROVIDE(func_800405d0 = Sprite_Init);
PROVIDE(func_80040664 = Sprite_SetTexture);
PROVIDE(func_800406e4 = Entity_TestFlag);
PROVIDE(func_80040714 = Entity_SetFlag);
PROVIDE(func_80040740 = Entity_SetBlendMode);
PROVIDE(func_8004076c = Entity_ApplyColor);
PROVIDE(func_80040790 = Color_AddOrSet);
PROVIDE(func_800407f8 = Entity_SetColor);
PROVIDE(func_80040824 = Entity_SetPosition);
PROVIDE(func_80040854 = Entity_Complete);
PROVIDE(func_800408a0 = Entity_SetDuration);
PROVIDE(func_800408a8 = Entity_SetLoopMask);
PROVIDE(func_800408bc = Primitive_GetVtable);
PROVIDE(func_800408cc = TextInput_New);
PROVIDE(func_80040948 = TextInput_InitLabels);
PROVIDE(func_80040a30 = TextInput_Destroy);
PROVIDE(func_80040a88 = TextInput_Activate);
PROVIDE(func_80040ae8 = TextInput_Draw);
PROVIDE(func_80040c00 = TextInput_Kill);
PROVIDE(func_80040cd0 = TextInput_Update);
PROVIDE(func_80040d74 = TextInput_SetPosition);
PROVIDE(func_80040e14 = TextInput_DrawPositioned);
PROVIDE(func_80040edc = TextInput_SetChar);
PROVIDE(func_80040f20 = TextInput_Return);
PROVIDE(func_80040f28 = TextInput_PrintString);
PROVIDE(func_80040fa0 = TextInput_Nop);
PROVIDE(func_80040fa8 = TextInput_SetSpacing);
PROVIDE(func_80040fb0 = TextInput_GetVtable);
PROVIDE(func_80040fc0 = Sjis_Decode);
PROVIDE(func_80041020 = Sjis_EncodeFromAscii);
PROVIDE(func_8004109c = Sjis_FormatNumber);
PROVIDE(func_80041ab4 = TextInput_NewLabel);
PROVIDE(func_80041AB4 = TextInput_NewLabel);
PROVIDE(func_80041c3c = Label_GetVtable);
PROVIDE(func_80041C3C = Label_GetVtable);
PROVIDE(func_80042400 = StageGrid_New);
PROVIDE(func_80042694 = StageRow_New);
PROVIDE(func_800441b4 = NavMenu_NewPage);
PROVIDE(func_800441B4 = NavMenu_NewPage);
PROVIDE(func_80044cd4 = NavMenu_NewList);
PROVIDE(func_80044CD4 = NavMenu_NewList);
PROVIDE(func_80044f30 = NavMenu_NewMenu);
PROVIDE(func_80044F30 = NavMenu_NewMenu);
PROVIDE(func_80045438 = Spu_NewSeqTrack);

PROVIDE(func_80026410 = GameStateCheck);

/* Phase 6 rename: PascalCase PROVIDE aliases */
PROVIDE(func_800118dc = main);
PROVIDE(func_80011994 = __main);
PROVIDE(GetCoordSystemVtable = func_80018390);
PROVIDE(func_8001e57c = GetPrimitiveBaseTablePtr);
PROVIDE(func_8001E57C = GetPrimitiveBaseTablePtr);
PROVIDE(CdModePoll = func_80026cac);
PROVIDE(func_80026ce8 = CdModeStoreTriplet);
PROVIDE(func_80026cfc = CdModeRunTask);
PROVIDE(func_80026e0c = CdModeStartReading);
PROVIDE(func_80026e38 = CdModeStopReading);
PROVIDE(func_8002cc28 = AnimGetCurrentId);
PROVIDE(func_80030404 = EntitySetParam);
PROVIDE(func_80030584 = EntityGetParam);
PROVIDE(func_80032368 = SpuinitWrapper);
PROVIDE(func_80036a54 = SpuParamSetter);
PROVIDE(D_80088D16 = SPECIAL_DAYS + 0x4A);
PROVIDE(func_80025f7c = EntityAllocSmall);
PROVIDE(func_80025F7C = EntityAllocSmall);
PROVIDE(func_80025e1c = PadManagerPollInput);
PROVIDE(func_80025E1C = PadManagerPollInput);
PROVIDE(func_8005bf68 = SoundSetTeleportFlag);
PROVIDE(func_8005BF68 = SoundSetTeleportFlag);
PROVIDE(func_8001ec84 = MathFixedDiv);
PROVIDE(func_8001EC84 = MathFixedDiv);
PROVIDE(func_80025c30 = PadManagerAlloc);
PROVIDE(func_80025C30 = PadManagerAlloc);
PROVIDE(func_80017b34 = MemAllocImpl);
PROVIDE(func_80017B34 = MemAllocImpl);
PROVIDE(func_80025ba0 = PadManagerConfigure);
PROVIDE(func_80025BA0 = PadManagerConfigure);
PROVIDE(func_80025c84 = PadManagerSetEnabled);
PROVIDE(func_80025C84 = PadManagerSetEnabled);
PROVIDE(func_80025b34 = PadManagerConstructor);
PROVIDE(func_80025B34 = PadManagerConstructor);
PROVIDE(func_8001ce30 = SceneNodeInitCoords);
PROVIDE(func_8001CE30 = SceneNodeInitCoords);
PROVIDE(func_80017cfc = MemFreeImpl);
PROVIDE(func_80017CFC = MemFreeImpl);
PROVIDE(func_80025d10 = PadManagerUpdate);
PROVIDE(func_80025D10 = PadManagerUpdate);
PROVIDE(func_80025cc4 = PadManagerDestructor);
PROVIDE(func_80025CC4 = PadManagerDestructor);
PROVIDE(func_80025e94 = PadManagerAnalogStick);
PROVIDE(func_80025E94 = PadManagerAnalogStick);
PROVIDE(func_80025e14 = PadManagerUnknownA);
PROVIDE(func_80025E14 = PadManagerUnknownA);

/* PROVIDE aliases for DreamSys_nonmatchings.c PascalCase functions */
PROVIDE(func_800593D8 = EntityDispatchCallbacks);
PROVIDE(func_800593d8 = EntityDispatchCallbacks);
PROVIDE(func_80058A94 = EntityProcessManagerState);
PROVIDE(func_80058a94 = EntityProcessManagerState);
PROVIDE(func_80058E8C = EntityProcessActionNormalize);
PROVIDE(func_80058e8c = EntityProcessActionNormalize);
PROVIDE(func_80058F18 = EntityProcessActionSpecial);
PROVIDE(func_80058f18 = EntityProcessActionSpecial);
PROVIDE(func_800590E8 = EntityCalcDreamColor);
PROVIDE(func_800590e8 = EntityCalcDreamColor);
PROVIDE(func_800591B4 = EntityResetState);
PROVIDE(func_800591b4 = EntityResetState);
PROVIDE(func_8005A134 = EntityResetAnimation);
PROVIDE(func_8005a134 = EntityResetAnimation);
PROVIDE(func_8005A168 = EntityGetSetDreamColor);
PROVIDE(func_8005a168 = EntityGetSetDreamColor);
PROVIDE(func_8005A184 = EntitySetDreamColorCond);
PROVIDE(func_8005a184 = EntitySetDreamColorCond);
PROVIDE(func_8005A1A4 = EntityRevertDreamColor);
PROVIDE(func_8005a1a4 = EntityRevertDreamColor);
PROVIDE(func_8005A1B0 = EntitySetCoordOffsets);
PROVIDE(func_8005a1b0 = EntitySetCoordOffsets);
PROVIDE(func_8005A1EC = EntitySetField120);
PROVIDE(func_8005a1ec = EntitySetField120);
PROVIDE(func_8005A2E4 = EntityGetMoodData);
PROVIDE(func_8005a2e4 = EntityGetMoodData);
PROVIDE(func_8005A33C = EntityClearField878);
PROVIDE(func_8005a33c = EntityClearField878);
PROVIDE(func_8005A344 = EntityGetField878);
PROVIDE(func_8005a344 = EntityGetField878);
PROVIDE(func_8005A350 = EntityGetMoodGraphBuffer);
PROVIDE(func_8005a350 = EntityGetMoodGraphBuffer);
PROVIDE(func_80059590 = EntityClearField7C);
PROVIDE(func_80059598 = EntityClearField78);
PROVIDE(func_800595A0 = EntityReturnZero);
PROVIDE(func_800595a0 = EntityReturnZero);
PROVIDE(func_800595A8 = EntityCleanupState);
PROVIDE(func_800595a8 = EntityCleanupState);
PROVIDE(func_80059610 = EntityEndAction);
PROVIDE(func_800597C0 = EntityDispatchAction);
PROVIDE(func_800597c0 = EntityDispatchAction);
PROVIDE(func_80059148 = EntitySetActionType);
PROVIDE(func_80059A58 = EntityDispatchByActionType);
PROVIDE(func_80059a58 = EntityDispatchByActionType);
PROVIDE(func_80059AEC = EntityRunActionCheck);
PROVIDE(func_80059aec = EntityRunActionCheck);
PROVIDE(func_80059B50 = EntityRunActionState);
PROVIDE(func_80059b50 = EntityRunActionState);
PROVIDE(func_80059BD4 = EntitySetCounterFlag);
PROVIDE(func_80059bd4 = EntitySetCounterFlag);
PROVIDE(func_8005A050 = EntityApplyShakePalette);
PROVIDE(func_8005a050 = EntityApplyShakePalette);
PROVIDE(func_8005A0B0 = EntityUpdateShakeEffect);
PROVIDE(func_8005a0b0 = EntityUpdateShakeEffect);
PROVIDE(func_80058B08 = EntityProcessActionDetailed);
PROVIDE(func_80058b08 = EntityProcessActionDetailed);
PROVIDE(func_80058C58 = EntitySetActionByCode);
PROVIDE(func_80058c58 = EntitySetActionByCode);
PROVIDE(func_8005966C = EntitySetModeVtable);
PROVIDE(func_8005966c = EntitySetModeVtable);
PROVIDE(func_800596E8 = EntitySetAnimModeVtable);
PROVIDE(func_800596e8 = EntitySetAnimModeVtable);
PROVIDE(func_80059BE0 = EntityCounterStateMachine);
PROVIDE(func_80059be0 = EntityCounterStateMachine);
PROVIDE(func_80059E3C = EntityClearSoundEffect);
PROVIDE(func_80059e3c = EntityClearSoundEffect);
PROVIDE(func_8005AFD0 = EntityGetLinkOffset);
PROVIDE(func_8005afd0 = EntityGetLinkOffset);
PROVIDE(func_8005BA20 = EntityGetSetStairField);
PROVIDE(func_8005ba20 = EntityGetSetStairField);
PROVIDE(func_8005BB14 = LinkGetAngleFromTable);
PROVIDE(func_8005bb14 = LinkGetAngleFromTable);
PROVIDE(func_8005BF48 = LinkGetStairDefaultData);
PROVIDE(func_8005bf48 = LinkGetStairDefaultData);
PROVIDE(func_8005BFC4 = LinkGetInstantTeleportFlagOffset);
PROVIDE(func_8005bfc4 = LinkGetInstantTeleportFlagOffset);
PROVIDE(func_8005C118 = StairGetTypeIndex);
PROVIDE(func_8005c118 = StairGetTypeIndex);

PROVIDE(func_800624BC = EntityBehavior_RandomMove);
PROVIDE(func_80062570 = EntityBehavior_InitMoveAim);
PROVIDE(func_80061A90 = EntityBehavior_RandomDirState);
PROVIDE(func_80062970 = EntityBehavior_AnimOnFlag);
PROVIDE(func_80026FE8 = CdModeBranchMode13B);
PROVIDE(func_800641C0 = EntityBehavior_PeriodicStateEnd);
PROVIDE(func_800650D4 = EntityBehavior_Nop2);
PROVIDE(func_80065238 = EntityBehavior_AnimateThenReset);
PROVIDE(func_80064AA4 = EntityBehavior_AnimDecel);
PROVIDE(func_800602AC = EntityBehavior_FallbackState);
PROVIDE(func_80026E64 = CdModeCheckIsMode13);
PROVIDE(func_8006204C = EntityBehavior_PeriodicStateD);
PROVIDE(func_80026ECC = CdModeCheckMode13A);
PROVIDE(func_800620C4 = EntityBehavior_DelayedAnim);
PROVIDE(func_80061C04 = EntityBehavior_TriggerAt30);
PROVIDE(func_80063D40 = EntityBehavior_MidpointTrigger);
PROVIDE(func_80064294 = EntityBehavior_EndOfLifeAnim);
PROVIDE(func_80060800 = EntityBehavior_InitAimState);
PROVIDE(func_80063874 = EntityBehavior_ComplexStateMachine);
PROVIDE(func_80063CAC = EntityState_SetTrigger);
PROVIDE(func_8006519C = EntityBehavior_PlayAnim238A);
PROVIDE(func_80063ED4 = EntityBehavior_ChildScan);
PROVIDE(func_80064450 = EntityBehavior_RollAtBounds);
PROVIDE(func_80061F30 = EntityBehavior_SubStateAnim);
PROVIDE(func_80063BC0 = EntityBehavior_PhaseEnd);
PROVIDE(func_80063CC8 = EntityBehavior_WrapState);
PROVIDE(func_800650F4 = EntityBehavior_RandomAnimSelect);
PROVIDE(func_80064CA4 = EntityBehavior_AnimWithOffset);
PROVIDE(func_80063DC8 = EntityBehavior_TriggerOnDelay);
PROVIDE(func_80061400 = EntityBehavior_ProximityMultiState);
PROVIDE(func_800654A0 = EntityBehavior_AimAndAnimate);
PROVIDE(func_80060B34 = EntityBehavior_FlagDrivenState);
PROVIDE(func_80060148 = EntityBehavior_PeriodicAnimSwitch);
PROVIDE(func_800646D8 = EntityBehavior_ProgressiveAnim);
PROVIDE(func_80064D48 = EntityBehavior_ProximitySubstate);
PROVIDE(func_80026C88 = CdModeSetFlag9);
PROVIDE(func_80060D80 = EntityBehavior_TimedAnimSwitch);
PROVIDE(func_80065204 = EntityBehavior_PlayAnim1CC);
PROVIDE(func_80026E98 = CdModeCheckIsNotMode13);
PROVIDE(func_80026900 = SpuPlaySequence);
PROVIDE(func_80063E68 = EntityBehavior_RandomBranchState);
PROVIDE(func_800651D0 = EntityBehavior_PlayAnim238B);
PROVIDE(func_800623E8 = EntityBehavior_MultiPeriodState);
PROVIDE(func_80027130 = StrCat);
PROVIDE(func_80060CF0 = EntityBehavior_StateOnMatch);
PROVIDE(func_80062C58 = EntityBehavior_MultiPhaseMove);
PROVIDE(func_80061E60 = EntityBehavior_ModuloState);
PROVIDE(func_800603C4 = EntityBehavior_ThresholdTrigger);
PROVIDE(func_80064B80 = EntityBehavior_OscillateMove);
PROVIDE(func_80064618 = EntityBehavior_ChildOpOnFlag);
PROVIDE(func_80064FBC = EntityBehavior_ThresholdRangeReset);
PROVIDE(func_80026FAC = CdModeBranchMode13A);
PROVIDE(func_80062FAC = EntityBehavior_PeriodicSubstate);
PROVIDE(func_80062660 = EntityBehavior_InitTargetState);
PROVIDE(func_80062A40 = EntityBehavior_TimedAnimState);
PROVIDE(func_80026698 = EntityProcessStageAlloc);
PROVIDE(func_80061778 = EntityBehavior_TimerProximityState);
PROVIDE(func_800607F8 = EntityBehavior_Nop);
PROVIDE(func_80025FDC = CdModeInitDream);
PROVIDE(func_80064078 = EntityBehavior_ScanOrAim);
PROVIDE(func_80064E34 = EntityBehavior_MultiPhaseThreshold);
PROVIDE(func_80026F00 = CdModeCheckMode13B);
PROVIDE(func_80063784 = EntityBehavior_MultiThresholdState);
PROVIDE(func_80064928 = EntityBehavior_TimedChildOp);
PROVIDE(func_800644E8 = EntityBehavior_RandomRoll);
PROVIDE(func_80060A4C = EntityBehavior_OscillateVelocity);
PROVIDE(func_80061198 = EntityBehavior_MultiMoveState);
PROVIDE(func_80061070 = EntityBehavior_ThresholdAnimState);
PROVIDE(func_80064CEC = EntityBehavior_AnimAndMove);
PROVIDE(func_80063094 = EntityBehavior_BoundCheckState);
PROVIDE(func_800634A8 = EntityBehavior_RandomAnimPhase);
PROVIDE(func_80060F38 = EntityBehavior_AnimPhaseState);
PROVIDE(func_800604DC = EntityBehavior_RandomAnimState);
PROVIDE(func_80063144 = EntityBehavior_MultiDirState);
PROVIDE(func_80026C80 = CdModeReturnZero);
PROVIDE(func_80061C2C = EntityBehavior_ProximityComplex);
PROVIDE(func_80063C84 = EntityState_SetFields);
PROVIDE(func_800605D0 = EntityBehavior_RandomAnimMove);
PROVIDE(func_80064B14 = EntityBehavior_RandomActivate);
PROVIDE(func_800628D4 = EntityBehavior_InitResetState);
PROVIDE(func_80062730 = EntityBehavior_InitThenMove);
PROVIDE(func_8006536C = EntityBehavior_PeriodicAnimState);
PROVIDE(func_80065514 = EntityBehavior_RandomSubstate);
PROVIDE(func_80061158 = EntitySetInitVelocity);
PROVIDE(func_8006090C = EntityBehavior_ChildInteraction);
PROVIDE(func_800636E4 = EntityBehavior_PeriodicReset);
PROVIDE(func_80026690 = NopSub_26690);
PROVIDE(func_800621A8 = EntityBehavior_DirectionState);
PROVIDE(func_80060710 = EntityBehavior_RandomAnim);